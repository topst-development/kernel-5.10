// SPDX-License-Identifier: (GPL-2.0-or-later OR MIT)
/*
 * Copyright (C) 2023 Telechips Inc.
 */

#include "tcc803x-subcore-videoinput-reserved-memory.dtsi"
#include "tcc8031pe-lpd4321-videoinput.dtsi"
#include "../tcc803x-subcore-camipc.dtsi"
