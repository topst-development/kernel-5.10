// SPDX-License-Identifier: (GPL-2.0-or-later OR MIT)
/*
 * Copyright (C) 2023 Telechips Inc.
 */

#include <dt-bindings/clock/telechips,tcc803x-clks.h>
#include <dt-bindings/interrupt-controller/arm-gic.h>

/ {
	tcc_cb_wdt: tcc_cb_wdt {
		compatible = "telechips,tcc-cb-wdt";
		reg =   <0x17040000 0x10000>, /* watchdog kick timer */
			<0x17050000 0x10000>; /* real watchdog */

		clocks = <&clk_peri PERI_CB_WDT>;
		clock-names = "clk_wdt";

		assigned-clocks = <&clk_peri PERI_CB_WDT>;
		assigned-clock-rates = <12000000>;

		interrupts = <GIC_SPI 121 IRQ_TYPE_LEVEL_HIGH>;

		kick-interval = <5>;
		timeout-sec = <20>;
	};
};
