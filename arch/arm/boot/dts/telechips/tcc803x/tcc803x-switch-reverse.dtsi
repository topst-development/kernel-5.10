// SPDX-License-Identifier: (GPL-2.0-or-later OR MIT)
/*
 * Copyright (C) Telechips Inc.
 */

&aliases {
	switch0 = &switch0;
};

/ {
	switch0: switch0 {
		compatible = "telechips,switch";
		status = "disabled";
	};
};
