// SPDX-License-Identifier: (GPL-2.0-or-later OR MIT)
/*
 * Copyright (C) Telechips Inc.
 */

&aliases {
	camipc0 = &camipc0;
};

/ {
	camipc0: camipc0 {
		compatible = "telechips,camipc";
		status = "okay";
		device-name = "camipc_sub";
		protocol = "CAM0";
		tcc_ipi = <&tcc_ipi_sub>;
	};
};