// SPDX-License-Identifier: (GPL-2.0-or-later OR MIT)
/*
 * Copyright (C) Telechips Inc.
 */

/ {
	tstr: tcc_touch_receive {
		compatible = "telechips,tcc_touch_receive";
		tcc_ipi = <&tcc_ipi_main>;
	status = "okay";
		xmax = <1920>;
		ymax = <720>;
	};
};

