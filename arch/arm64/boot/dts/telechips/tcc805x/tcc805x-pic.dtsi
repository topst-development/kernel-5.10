// SPDX-License-Identifier: (GPL-2.0-or-later OR MIT)
/*
 * Copyright (C) 2023 Telechips Inc.
 */

/ {
	tcc_pic: pic@14100000 {
		compatible = "telechips,tcc805x-pic";
		reg = <0x0 0x141000E0 0x0 0x0018>,  /* pol_0_base */
		      <0x0 0x14600100 0x0 0x0024>,  /* pol_1_base */
		      <0x0 0x14800040 0x0 0x003C>,  /* cmb_cm4_base */
		      <0x0 0x14900040 0x0 0x003C>,  /* strgb_cm4_base */
		      <0x0 0x0 0x0 0x0>;            /* ca7_irqo_en_base */
		demarcation = <192>;
		max_irq = <480>;
		have-syscore-ops;
	};
};
