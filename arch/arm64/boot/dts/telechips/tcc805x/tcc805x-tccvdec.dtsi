// SPDX-License-Identifier: (GPL-2.0-or-later OR MIT)
/*
 * Copyright (C) 2023 Telechips Inc.
 */
/
{
	vdec_drv0: vdec_drv@0 {
			compatible = "telechips,v4l2_vdec";
			reg = <0x0 0x0 0x0 0x0>;
			status = "okay";
		};
};