// SPDX-License-Identifier: (GPL-2.0-or-later OR MIT)
/*
 * Copyright (C) 2023 Telechips Inc.
 */

#include <dt-bindings/board/telechips.h>

#ifndef DT_OVERLAY
#include "tcc805x.dts"
#endif

/ {
	model = "Telechips TCC8050 LPD4X322 1.0 Main Core";
	board-id = <BOARD_ID_TCC8050_EVB>;
	board-rev = <0x1>;
};

#include "override/tcc805x-wdt.dtsi"
#include "override/tcc805x-dma.dtsi"
#include "override/tcc805x-scfw.dtsi"
#include "override/tcc805x-ufs.dtsi"
#include "override/tcc805x-gmac.dtsi"
#include "override/tcc805x-adc.dtsi"
#include "override/tcc805x-audio.dtsi"
#include "override/tcc805x-vpu.dtsi"
#include "override/tcc8050-cpu.dtsi"
#include "override/tcc8050_53-lpd4x322-sv1.0-gpio.dtsi"
#include "override/tcc8050_53-lpd4x322-uart.dtsi"
#include "override/tcc8050_53-lpd4x322-mmc.dtsi"
#include "override/tcc8050_53-lpd4x322-sv1.0-i2c.dtsi"
#include "override/tcc8050_53-lpd4x322-spi.dtsi"
#include "override/tcc8050_53-lpd4x322-ictc.dtsi"
#include "override/tcc8050_53-lpd4x322-timer.dtsi"
#include "override/tcc8050_53-lpd4x322-sv1.0-usb.dtsi"
#include "override/tcc8050_53-lpd4x322-sv1.0-gmac.dtsi"
#include "override/tcc8050_53-lpd4x322-sv1.0-pcie.dtsi"
#include "override/tcc8050-lpd4x322-sv1.0-display.dtsi"
#include "override/tcc8050_53-lpd4x322-sv1.0-camera.dtsi"
