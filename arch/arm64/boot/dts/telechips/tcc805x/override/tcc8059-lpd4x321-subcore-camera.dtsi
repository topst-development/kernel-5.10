// SPDX-License-Identifier: (GPL-2.0-or-later OR MIT)
/*
 * Copyright (C) 2023 Telechips Inc.
 */

#include "tcc805x-subcore-videoinput-reserved-memory.dtsi"
#include "tcc8059-lpd4x321-videoinput.dtsi"
#include "tcc805x-subcore-videoinput-camera-module.dtsi"
#include "../tcc805x-subcore-camipc.dtsi"
