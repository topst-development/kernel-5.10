// SPDX-License-Identifier: (GPL-2.0-or-later OR MIT)
/*
 * Copyright (C) 2023 Telechips Inc.
 */

/* eMMC */
&tcc_sc_mmc {
	status = "okay";

	max-frequency = <200000000>;
	bus-width = <8>;

	no-sdio;
	no-sd;
	non-removable;
	keep-power-in-suspend;
	disable-wp;

	mmc-hs400-1_8v;
	mmc-hs400-enhanced-strobe;
	vqmmc-supply = <&vqmmc_emmc>;
};

&vqmmc_emmc {
	compatible = "regulator-fixed";
	regulator-name = "vqmmc_emmc";
	regulator-min-microvolt = <1800000>;
	regulator-max-microvolt = <1800000>;
	regulator-always-on;
};
