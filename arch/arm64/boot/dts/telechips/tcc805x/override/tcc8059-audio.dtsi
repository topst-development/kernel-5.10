/* SPDX-License-Identifier: (GPL-2.0-or-later OR MIT) */
/*
 * Copyright (C) 2023 Telechips Inc.
 */

&pinctrl {
/*****************************************************
* Audio PinCtrl Start
******************************************************/
/*****************************************************
* Multi DAI Port_0 m1:multi, dai0:port0
******************************************************/

	m1dai0_mclk: m1dai0_mclk{
		telechips,pins = "gpa-25";
		telechips,pin-function = <5>;
		telechips,input_buffer_enable;
	};

	m1dai0_mclk_idle: m1dai0_mclk_idle{
		telechips,pins = "gpa-25";
		telechips,pin-function = <0>;
	telechips,output-low = <0>;
	};

	m1dai0_bclk: m1dai0_bclk{
		telechips,pins = "gpa-26";
		telechips,pin-function = <5>;
		telechips,input_buffer_enable;
	};

	m1dai0_bclk_idle: m1dai0_bclk_idle{
		telechips,pins = "gpa-26";
		telechips,pin-function = <0>;
	telechips,output-low = <0>;
	};

	m1dai0_lrck: m1dai0_lrck{
		telechips,pins = "gpa-27";
		telechips,pin-function = <5>;
		telechips,input_buffer_enable;
	};

	m1dai0_lrck_idle: m1dai0_lrck_idle{
		telechips,pins = "gpa-27";
		telechips,pin-function = <0>;
	telechips,output-low = <0>;
	};

	m1dai0_dao0: m1dai0_dao0{
		telechips,pins = "gpa-24";
		telechips,pin-function = <5>;
	};

	m1dai0_dao0_idle: m1dai0_dao0_idle{
		telechips,pins = "gpa-24";
		telechips,pin-function = <0>;
	telechips,output-low = <0>;
	};

	m1dai0_dai0: m1dai0_dai0{
		telechips,pins = "gpa-28";
		telechips,pin-function = <5>;
		telechips,input_buffer_enable;
	};

	m1dai0_dai0_idle: m1dai0_dai0_idle{
		telechips,pins = "gpa-28";
		telechips,pin-function = <0>;
	telechips,output-low = <0>;
	};

	m1dai0_dao1: m1dai0_dao1{
		telechips,pins = "gpa-23";
		telechips,pin-function = <5>;
	};

	m1dai0_dao1_idle: m1dai0_dao1_idle{
		telechips,pins = "gpa-23";
		telechips,pin-function = <0>;
	telechips,output-low = <0>;
	};

	m1dai0_dai1: m1dai0_dai1{
		telechips,pins = "gpa-29";
		telechips,pin-function = <5>;
		telechips,input_buffer_enable;
	};

	m1dai0_dai1_idle: m1dai0_dai1_idle{
		telechips,pins = "gpa-29";
		telechips,pin-function = <0>;
	telechips,output-low = <0>;
	};

	m1dai0_dao2: m1dai0_dao2{
		telechips,pins = "gpa-22";
		telechips,pin-function = <5>;
	};

	m1dai0_dao2_idle: m1dai0_dao2_idle{
		telechips,pins = "gpa-22";
		telechips,pin-function = <0>;
	telechips,output-low = <0>;
	};

	m1dai0_dai2: m1dai0_dai2{
		telechips,pins = "gpa-30";
		telechips,pin-function = <5>;
		telechips,input_buffer_enable;
	};

	m1dai0_dai2_idle: m1dai0_dai2_idle{
		telechips,pins = "gpa-30";
		telechips,pin-function = <0>;
	telechips,output-low = <0>;
	};

	m1dai0_dao3: m1dai0_dao3{
		telechips,pins = "gpa-21";
		telechips,pin-function = <5>;
	};

	m1dai0_dao3_idle: m1dai0_dao3_idle{
		telechips,pins = "gpa-21";
		telechips,pin-function = <0>;
		telechips,output-low = <0>;
	};

	m1dai0_dai3: m1dai0_dai3{
		telechips,pins = "gpa-31";
		telechips,pin-function = <5>;
		telechips,input_buffer_enable;
	};

	m1dai0_dai3_idle: m1dai0_dai3_idle{
		telechips,pins = "gpa-31";
		telechips,pin-function = <0>;
	telechips,output-low = <0>;
	};

/*****************************************************
* Multi DAI Port_1 m1:multi, dai1:port1
******************************************************/

	m1dai1_mclk: m1dai1_mclk{
		telechips,pins = "gpc-19";
		telechips,pin-function = <1>;
		telechips,input_buffer_enable;
	};

	m1dai1_mclk_idle: m1dai1_mclk_idle{
		telechips,pins = "gpc-19";
		telechips,pin-function = <0>;
	telechips,output-low = <0>;
	};

	m1dai1_bclk: m1dai1_bclk{
		telechips,pins = "gpc-20";
		telechips,pin-function = <1>;
		telechips,input_buffer_enable;
	};

	m1dai1_bclk_idle: m1dai1_bclk_idle{
		telechips,pins = "gpc-20";
		telechips,pin-function = <0>;
	telechips,output-low = <0>;
	};

	m1dai1_lrck: m1dai1_lrck{
		telechips,pins = "gpc-21";
		telechips,pin-function = <1>;
		telechips,input_buffer_enable;
	};

	m1dai1_lrck_idle: m1dai1_lrck_idle{
		telechips,pins = "gpc-21";
		telechips,pin-function = <0>;
	telechips,output-low = <0>;
	};

	m1dai1_dao0: m1dai1_dao0{
		telechips,pins = "gpc-26";
		telechips,pin-function = <1>;
	};

	m1dai1_dao0_idle: m1dai1_dao0_idle{
		telechips,pins = "gpc-26";
		telechips,pin-function = <0>;
	telechips,output-low = <0>;
	};

	m1dai1_dai0: m1dai1_dai0{
		telechips,pins = "gpc-22";
		telechips,pin-function = <1>;
		telechips,input_buffer_enable;
	};

	m1dai1_dai0_idle: m1dai1_dai0_idle{
		telechips,pins = "gpc-22";
		telechips,pin-function = <0>;
	telechips,output-low = <0>;
	};

	m1dai1_dao1: m1dai1_dao1{
		telechips,pins = "gpc-27";
		telechips,pin-function = <1>;
	};

	m1dai1_dao1_idle: m1dai1_dao1_idle{
		telechips,pins = "gpc-27";
		telechips,pin-function = <0>;
	telechips,output-low = <0>;
	};

	m1dai1_dai1: m1dai1_dai1{
		telechips,pins = "gpc-23";
		telechips,pin-function = <1>;
		telechips,input_buffer_enable;
	};

	m1dai1_dai1_idle: m1dai1_dai1_idle{
		telechips,pins = "gpc-23";
		telechips,pin-function = <0>;
	telechips,output-low = <0>;
	};

	m1dai1_dao2: m1dai1_dao2{
		telechips,pins = "gpc-28";
		telechips,pin-function = <1>;
	};

	m1dai1_dao2_idle: m1dai1_dao2_idle{
		telechips,pins = "gpc-28";
		telechips,pin-function = <0>;
	telechips,output-low = <0>;
	};

	m1dai1_dai2: m1dai1_dai2{
		telechips,pins = "gpc-24";
		telechips,pin-function = <1>;
		telechips,input_buffer_enable;
	};

	m1dai1_dai2_idle: m1dai1_dai2_idle{
		telechips,pins = "gpc-24";
		telechips,pin-function = <0>;
	telechips,output-low = <0>;
	};

	m1dai1_dao3: m1dai1_dao3{
		telechips,pins = "gpc-29";
		telechips,pin-function = <1>;
	};

	m1dai1_dao3_idle: m1dai1_dao3_idle{
		telechips,pins = "gpc-29";
		telechips,pin-function = <0>;
	telechips,output-low = <0>;
	};

	m1dai1_dai3: m1dai1_dai3{
		telechips,pins = "gpc-25";
		telechips,pin-function = <1>;
		telechips,input_buffer_enable;
	};

	m1dai1_dai3_idle: m1dai1_dai3_idle{
		telechips,pins = "gpc-25";
		telechips,pin-function = <0>;
	telechips,output-low = <0>;
	};

/*****************************************************
* Multi DAI Port_2 m1:multi, dai2:port2
******************************************************/

	m1dai2_mclk: m1dai2_mclk{
		telechips,pins = "gpg-0";
		telechips,pin-function = <1>;
		telechips,input_buffer_enable;
	};

	m1dai2_mclk_idle: m1dai2_mclk_idle{
		telechips,pins = "gpg-0";
		telechips,pin-function = <0>;
	telechips,output-low = <0>;
	};

	m1dai2_bclk: m1dai2_bclk{
		telechips,pins = "gpg-1";
		telechips,pin-function = <1>;
		telechips,input_buffer_enable;
	};

	m1dai2_bclk_idle: m1dai2_bclk_idle{
		telechips,pins = "gpg-1";
		telechips,pin-function = <0>;
	telechips,output-low = <0>;
	};

	m1dai2_lrck: m1dai2_lrck{
		telechips,pins = "gpg-2";
		telechips,pin-function = <1>;
		telechips,input_buffer_enable;
	};

	m1dai2_lrck_idle: m1dai2_lrck_idle{
		telechips,pins = "gpg-2";
		telechips,pin-function = <0>;
	telechips,output-low = <0>;
	};

	m1dai2_dao0: m1dai2_dao0{
		telechips,pins = "gpg-3";
		telechips,pin-function = <1>;
	};

	m1dai2_dao0_idle: m1dai2_dao0_idle{
		telechips,pins = "gpg-3";
		telechips,pin-function = <0>;
	telechips,output-low = <0>;
	};

	m1dai2_dai0: m1dai2_dai0{
		telechips,pins = "gpg-4";
		telechips,pin-function = <1>;
		telechips,input_buffer_enable;
	};

	m1dai2_dai0_idle: m1dai2_dai0_idle{
		telechips,pins = "gpg-4";
		telechips,pin-function = <0>;
	telechips,output-low = <0>;
	};

	m1dai2_dao1: m1dai2_dao1{
		telechips,pins = "gpg-5";
		telechips,pin-function = <1>;
	};

	m1dai2_dao1_idle: m1dai2_dao1_idle{
		telechips,pins = "gpg-5";
		telechips,pin-function = <0>;
	telechips,output-low = <0>;
	};

	m1dai2_dai1: m1dai2_dai1{
		telechips,pins = "gpg-6";
		telechips,pin-function = <1>;
		telechips,input_buffer_enable;
	};

	m1dai2_dai1_idle: m1dai2_dai1_idle{
		telechips,pins = "gpg-6";
		telechips,pin-function = <0>;
	telechips,output-low = <0>;
	};

	m1dai2_dao2: m1dai2_dao2{
		telechips,pins = "gpg-7";
		telechips,pin-function = <1>;
	};

	m1dai2_dao2_idle: m1dai2_dao2_idle{
		telechips,pins = "gpg-7";
		telechips,pin-function = <0>;
	telechips,output-low = <0>;
	};

	m1dai2_dai2: m1dai2_dai2{
		telechips,pins = "gpg-8";
		telechips,pin-function = <1>;
		telechips,input_buffer_enable;
	};

	m1dai2_dai2_idle: m1dai2_dai2_idle{
		telechips,pins = "gpg-8";
		telechips,pin-function = <0>;
	telechips,output-low = <0>;
	};

	m1dai2_dao3: m1dai2_dao3{
		telechips,pins = "gpg-9";
		telechips,pin-function = <1>;
	};

	m1dai2_dao3_idle: m1dai2_dao3_idle{
		telechips,pins = "gpg-9";
		telechips,pin-function = <0>;
	telechips,output-low = <0>;
	};

	m1dai2_dai3: m1dai2_dai3{
		telechips,pins = "gpg-10";
		telechips,pin-function = <1>;
		telechips,input_buffer_enable;
	};

	m1dai2_dai3_idle: m1dai2_dai3_idle{
		telechips,pins = "gpg-10";
		telechips,pin-function = <0>;
	telechips,output-low = <0>;
	};

/*****************************************************
* Multi DAI Port_3 m1:multi, dai3:port3
******************************************************/

	m1dai3_mclk: m1dai3_mclk{
		telechips,pins = "gpe-0";
		telechips,pin-function = <1>;
		telechips,input_buffer_enable;
	};

	m1dai3_mclk_idle: m1dai3_mclk_idle{
		telechips,pins = "gpe-0";
		telechips,pin-function = <0>;
	telechips,output-low = <0>;
	};

	m1dai3_bclk: m1dai3_bclk{
		telechips,pins = "gpe-1";
		telechips,pin-function = <1>;
		telechips,input_buffer_enable;
	};

	m1dai3_bclk_idle: m1dai3_bclk_idle{
		telechips,pins = "gpe-1";
		telechips,pin-function = <0>;
	telechips,output-low = <0>;
	};

	m1dai3_lrck: m1dai3_lrck{
		telechips,pins = "gpe-2";
		telechips,pin-function = <1>;
		telechips,input_buffer_enable;
	};

	m1dai3_lrck_idle: m1dai3_lrck_idle{
		telechips,pins = "gpe-2";
		telechips,pin-function = <0>;
	telechips,output-low = <0>;
	};

	m1dai3_dao0: m1dai3_dao0{
		telechips,pins = "gpe-3";
		telechips,pin-function = <1>;
	};

	m1dai3_dao0_idle: m1dai3_dao0_idle{
		telechips,pins = "gpe-3";
		telechips,pin-function = <0>;
	telechips,output-low = <0>;
	};

	m1dai3_dai0: m1dai3_dai0{
		telechips,pins = "gpe-4";
		telechips,pin-function = <1>;
		telechips,input_buffer_enable;
	};

	m1dai3_dai0_idle: m1dai3_dai0_idle{
		telechips,pins = "gpe-4";
		telechips,pin-function = <0>;
	telechips,output-low = <0>;
	};

	m1dai3_dao1: m1dai3_dao1{
		telechips,pins = "gpe-5";
		telechips,pin-function = <1>;
	};

	m1dai3_dao1_idle: m1dai3_dao1_idle{
		telechips,pins = "gpe-5";
		telechips,pin-function = <0>;
	telechips,output-low = <0>;
	};

	m1dai3_dai1: m1dai3_dai1{
		telechips,pins = "gpe-6";
		telechips,pin-function = <1>;
		telechips,input_buffer_enable;
	};

	m1dai3_dai1_idle: m1dai3_dai1_idle{
		telechips,pins = "gpe-6";
		telechips,pin-function = <0>;
	telechips,output-low = <0>;
	};

	m1dai3_dao2: m1dai3_dao2{
		telechips,pins = "gpe-7";
		telechips,pin-function = <1>;
	};

	m1dai3_dao2_idle: m1dai3_dao2_idle{
		telechips,pins = "gpe-7";
		telechips,pin-function = <0>;
	telechips,output-low = <0>;
	};

	m1dai3_dai2: m1dai3_dai2{
		telechips,pins = "gpe-8";
		telechips,pin-function = <1>;
		telechips,input_buffer_enable;
	};

	m1dai3_dai2_idle: m1dai3_dai2_idle{
		telechips,pins = "gpe-8";
		telechips,pin-function = <0>;
	telechips,output-low = <0>;
	};

	m1dai3_dao3: m1dai3_dao3{
		telechips,pins = "gpe-9";
		telechips,pin-function = <1>;
	};

	m1dai3_dao3_idle: m1dai3_dao3_idle{
		telechips,pins = "gpe-9";
		telechips,pin-function = <0>;
	telechips,output-low = <0>;
	};

	m1dai3_dai3: m1dai3_dai3{
		telechips,pins = "gpe-10";
		telechips,pin-function = <1>;
		telechips,input_buffer_enable;
	};

	m1dai3_dai3_idle: m1dai3_dai3_idle{
		telechips,pins = "gpe-10";
		telechips,pin-function = <0>;
	telechips,output-low = <0>;
	};

/*****************************************************
* Stereo DAI Port_0 m0:Stereo, dai0:port0
******************************************************/

	m0dai0_mclk: m0dai0_mclk{
		telechips,pins = "gpc-25";
		telechips,pin-function = <2>;
		telechips,input_buffer_enable;
	};

	m0dai0_mclk_idle: m0dai0_mclk_idle{
		telechips,pins = "gpc-25";
		telechips,pin-function = <0>;
	telechips,output-low = <0>;
	};

	m0dai0_bclk: m0dai0_bclk{
		telechips,pins = "gpc-26";
		telechips,pin-function = <2>;
		telechips,input_buffer_enable;
	};

	m0dai0_bclk_idle: m0dai0_bclk_idle{
		telechips,pins = "gpc-26";
		telechips,pin-function = <0>;
	telechips,output-low = <0>;
	};

	m0dai0_lrck: m0dai0_lrck{
		telechips,pins = "gpc-27";
		telechips,pin-function = <2>;
		telechips,input_buffer_enable;
	};

	m0dai0_lrck_idle: m0dai0_lrck_idle{
		telechips,pins = "gpc-27";
		telechips,pin-function = <0>;
	telechips,output-low = <0>;
	};

	m0dai0_dao0: m0dai0_dao0{
		telechips,pins = "gpc-28";
		telechips,pin-function = <2>;
	};

	m0dai0_dao0_idle: m0dai0_dao0_idle{
		telechips,pins = "gpc-28";
		telechips,pin-function = <0>;
	telechips,output-low = <0>;
	};

	m0dai0_dai0: m0dai0_dai0{
		telechips,pins = "gpc-29";
		telechips,pin-function = <2>;
		telechips,input_buffer_enable;
	};

	m0dai0_dai0_idle: m0dai0_dai0_idle{
		telechips,pins = "gpc-29";
		telechips,pin-function = <0>;
	telechips,output-low = <0>;
	};

/*****************************************************
* Stereo DAI Port_1 m0:Stereo, dai1:port1
******************************************************/

	m0dai1_mclk: m0dai1_mclk{
		telechips,pins = "gpg-0";
		telechips,pin-function = <2>;
		telechips,input_buffer_enable;
	};

	m0dai1_mclk_idle: m0dai1_mclk_idle{
		telechips,pins = "gpg-0";
		telechips,pin-function = <0>;
	telechips,output-low = <0>;
	};

	m0dai1_bclk: m0dai1_bclk{
		telechips,pins = "gpg-1";
		telechips,pin-function = <2>;
		telechips,input_buffer_enable;
	};

	m0dai1_bclk_idle: m0dai1_bclk_idle{
		telechips,pins = "gpg-1";
		telechips,pin-function = <0>;
	telechips,output-low = <0>;
	};

	m0dai1_lrck: m0dai1_lrck{
		telechips,pins = "gpg-2";
		telechips,pin-function = <2>;
		telechips,input_buffer_enable;
	};

	m0dai1_lrck_idle: m0dai1_lrck_idle{
		telechips,pins = "gpg-2";
		telechips,pin-function = <0>;
	telechips,output-low = <0>;
	};

	m0dai1_dao0: m0dai1_dao0{
		telechips,pins = "gpg-3";
		telechips,pin-function = <2>;
	};

	m0dai1_dao0_idle: m0dai1_dao0_idle{
		telechips,pins = "gpg-3";
		telechips,pin-function = <0>;
	telechips,output-low = <0>;
	};

	m0dai1_dai0: m0dai1_dai0{
		telechips,pins = "gpg-4";
		telechips,pin-function = <2>;
		telechips,input_buffer_enable;
	};

	m0dai1_dai0_idle: m0dai1_dai0_idle{
		telechips,pins = "gpg-4";
		telechips,pin-function = <0>;
	telechips,output-low = <0>;
	};

/*****************************************************
* Stereo DAI Port_2 m0:Stereo, dai2:port2
******************************************************/

	m0dai2_mclk: m0dai2_mclk{
		telechips,pins = "gpg-6";
		telechips,pin-function = <2>;
		telechips,input_buffer_enable;
	};

	m0dai2_mclk_idle: m0dai2_mclk_idle{
		telechips,pins = "gpg-6";
		telechips,pin-function = <0>;
	telechips,output-low = <0>;
	};

	m0dai2_bclk: m0dai2_bclk{
		telechips,pins = "gpg-7";
		telechips,pin-function = <2>;
		telechips,input_buffer_enable;
	};

	m0dai2_bclk_idle: m0dai2_bclk_idle{
		telechips,pins = "gpg-7";
		telechips,pin-function = <0>;
	telechips,output-low = <0>;
	};

	m0dai2_lrck: m0dai2_lrck{
		telechips,pins = "gpg-8";
		telechips,pin-function = <2>;
		telechips,input_buffer_enable;
	};

	m0dai2_lrck_idle: m0dai2_lrck_idle{
		telechips,pins = "gpg-8";
		telechips,pin-function = <0>;
	telechips,output-low = <0>;
	};

	m0dai2_dao0: m0dai2_dao0{
		telechips,pins = "gpg-9";
		telechips,pin-function = <2>;
	};

	m0dai2_dao0_idle: m0dai2_dao0_idle{
		telechips,pins = "gpg-9";
		telechips,pin-function = <0>;
	telechips,output-low = <0>;
	};

	m0dai2_dai0: m0dai2_dai0{
		telechips,pins = "gpg-10";
		telechips,pin-function = <2>;
		telechips,input_buffer_enable;
	};

	m0dai2_dai0_idle: m0dai2_dai0_idle{
		telechips,pins = "gpg-10";
		telechips,pin-function = <0>;
	telechips,output-low = <0>;
	};

/*****************************************************
* Stereo DAI Port_3 m0:Stereo, dai3:port3
******************************************************/

	m0dai3_mclk: m0dai3_mclk{
		telechips,pins = "gpe-0";
		telechips,pin-function = <2>;
		telechips,input_buffer_enable;
	};

	m0dai3_mclk_idle: m0dai3_mclk_idle{
		telechips,pins = "gpe-0";
		telechips,pin-function = <0>;
		telechips,output-low = <0>;
	};

	m0dai3_bclk: m0dai3_bclk{
		telechips,pins = "gpe-1";
		telechips,pin-function = <2>;
		telechips,input_buffer_enable;
	};

	m0dai3_bclk_idle: m0dai3_bclk_idle{
		telechips,pins = "gpe-1";
		telechips,pin-function = <0>;
		telechips,output-low = <0>;
	};

	m0dai3_lrck: m0dai3_lrck{
		telechips,pins = "gpe-2";
		telechips,pin-function = <2>;
		telechips,input_buffer_enable;
	};

	m0dai3_lrck_idle: m0dai3_lrck_idle{
		telechips,pins = "gpe-2";
		telechips,pin-function = <0>;
		telechips,output-low = <0>;
	};

	m0dai3_dao0: m0dai3_dao0{
		telechips,pins = "gpe-3";
		telechips,pin-function = <2>;
	};

	m0dai3_dao0_idle: m0dai3_dao0_idle{
		telechips,pins = "gpe-3";
		telechips,pin-function = <0>;
		telechips,output-low = <0>;
	};

	m0dai3_dai0: m0dai3_dai0{
		telechips,pins = "gpe-4";
		telechips,pin-function = <2>;
		telechips,input_buffer_enable;
	};

	m0dai3_dai0_idle: m0dai3_dai0_idle{
		telechips,pins = "gpe-4";
		telechips,pin-function = <0>;
		telechips,output-low = <0>;
	};

/*****************************************************
* Stereo DAI Port_4 m0:Stereo, dai4:port4
******************************************************/

	m0dai4_mclk: m0dai4_mclk{
		telechips,pins = "gpe-10";
		telechips,pin-function = <2>;
		telechips,input_buffer_enable;
	};

	m0dai4_mclk_idle: m0dai4_mclk_idle{
		telechips,pins = "gpe-10";
		telechips,pin-function = <0>;
		telechips,output-low = <0>;
	};

	m0dai4_bclk: m0dai4_bclk{
		telechips,pins = "gpe-11";
		telechips,pin-function = <2>;
		telechips,input_buffer_enable;
	};

	m0dai4_bclk_idle: m0dai4_bclk_idle{
		telechips,pins = "gpe-11";
		telechips,pin-function = <0>;
		telechips,output-low = <0>;
	};

	m0dai4_lrck: m0dai4_lrck{
		telechips,pins = "gpe-12";
		telechips,pin-function = <2>;
		telechips,input_buffer_enable;
	};

	m0dai4_lrck_idle: m0dai4_lrck_idle{
		telechips,pins = "gpe-12";
		telechips,pin-function = <0>;
		telechips,output-low = <0>;
	};

	m0dai4_dao0: m0dai4_dao0{
		telechips,pins = "gpe-13";
		telechips,pin-function = <2>;
	};

	m0dai4_dao0_idle: m0dai4_dao0_idle{
		telechips,pins = "gpe-13";
		telechips,pin-function = <0>;
		telechips,output-low = <0>;
	};

	m0dai4_dai0: m0dai4_dai0{
		telechips,pins = "gpe-14";
		telechips,pin-function = <2>;
		telechips,input_buffer_enable;
	};

	m0dai4_dai0_idle: m0dai4_dai0_idle{
		telechips,pins = "gpe-14";
		telechips,pin-function = <0>;
		telechips,output-low = <0>;
	};

/*****************************************************
* Stereo DAI Port_5 m0:Stereo, dai5:port5
******************************************************/

	m0dai5_mclk: m0dai5_mclk{
		telechips,pins = "gpe-15";
		telechips,pin-function = <2>;
		telechips,input_buffer_enable;
	};

	m0dai5_mclk_idle: m0dai5_mclk_idle{
		telechips,pins = "gpe-15";
		telechips,pin-function = <0>;
		telechips,output-low = <0>;
	};

	m0dai5_bclk: m0dai5_bclk{
		telechips,pins = "gpe-16";
		telechips,pin-function = <2>;
		telechips,input_buffer_enable;
	};

	m0dai5_bclk_idle: m0dai5_bclk_idle{
		telechips,pins = "gpe-16";
		telechips,pin-function = <0>;
		telechips,output-low = <0>;
	};

	m0dai5_lrck: m0dai5_lrck{
		telechips,pins = "gpe-17";
		telechips,pin-function = <2>;
		telechips,input_buffer_enable;
	};

	m0dai5_lrck_idle: m0dai5_lrck_idle{
		telechips,pins = "gpe-17";
		telechips,pin-function = <0>;
		telechips,output-low = <0>;
	};

	m0dai5_dao0: m0dai5_dao0{
		telechips,pins = "gpe-18";
		telechips,pin-function = <2>;
	};

	m0dai5_dao0_idle: m0dai5_dao0_idle{
		telechips,pins = "gpe-18";
		telechips,pin-function = <0>;
		telechips,output-low = <0>;
	};

	m0dai5_dai0: m0dai5_dai0{
		telechips,pins = "gpe-19";
		telechips,pin-function = <2>;
		telechips,input_buffer_enable;
	};

	m0dai5_dai0_idle: m0dai5_dai0_idle{
		telechips,pins = "gpe-19";
		telechips,pin-function = <0>;
		telechips,output-low = <0>;
	};

/*****************************************************
* SPDIF Port spdif0:port0
******************************************************/

	spdif0_tx: spdif0_tx{
		telechips,pins = "gpe-5";
		telechips,pin-function = <3>;
	};

	spdif0_tx_idle: spdif0_tx_idle{
		telechips,pins = "gpe-5";
		telechips,pin-function = <0>;
		telechips,output-low = <0>;
	};

	spdif0_rx: spdif0_rx{
		telechips,pins = "gpe-5";
		telechips,pin-function = <4>;
		telechips,input_buffer_enable;
	};

	spdif0_rx_idle: spdif0_rx_idle{
		telechips,pins = "gpe-5";
		telechips,pin-function = <0>;
		telechips,output-low = <0>;
	};

	spdif1_tx: spdif1_tx{
		telechips,pins = "gpe-6";
		telechips,pin-function = <3>;
	};

	spdif1_tx_idle: spdif1_tx_idle{
		telechips,pins = "gpe-6";
		telechips,pin-function = <0>;
		telechips,output-low = <0>;
	};

	spdif1_rx: spdif1_rx{
		telechips,pins = "gpe-6";
		telechips,pin-function = <4>;
		telechips,input_buffer_enable;
	};

	spdif1_rx_idle: spdif1_rx_idle{
		telechips,pins = "gpe-6";
		telechips,pin-function = <0>;
		telechips,output-low = <0>;
	};

	spdif2_tx: spdif2_tx{
		telechips,pins = "gpe-7";
		telechips,pin-function = <3>;
	};

	spdif2_tx_idle: spdif2_tx_idle{
		telechips,pins = "gpe-7";
		telechips,pin-function = <0>;
		telechips,output-low = <0>;
	};

	spdif2_rx: spdif2_rx{
		telechips,pins = "gpe-7";
		telechips,pin-function = <4>;
		telechips,input_buffer_enable;
	};

	spdif2_rx_idle: spdif2_rx_idle{
		telechips,pins = "gpe-7";
		telechips,pin-function = <0>;
		telechips,output-low = <0>;
	};

	spdif3_tx: spdif3_tx{
		telechips,pins = "gpe-8";
		telechips,pin-function = <3>;
	};

	spdif3_tx_idle: spdif3_tx_idle{
		telechips,pins = "gpe-8";
		telechips,pin-function = <0>;
		telechips,output-low = <0>;
	};

	spdif3_rx: spdif3_rx{
		telechips,pins = "gpe-8";
		telechips,pin-function = <4>;
		telechips,input_buffer_enable;
	};

	spdif3_rx_idle: spdif3_rx_idle{
		telechips,pins = "gpe-8";
		telechips,pin-function = <0>;
		telechips,output-low = <0>;
	};

	spdif4_tx: spdif4_tx{
		telechips,pins = "gpe-9";
		telechips,pin-function = <3>;
	};

	spdif4_tx_idle: spdif4_tx_idle{
		telechips,pins = "gpe-9";
		telechips,pin-function = <0>;
		telechips,output-low = <0>;
	};

	spdif4_rx: spdif4_rx{
		telechips,pins = "gpe-9";
		telechips,pin-function = <4>;
		telechips,input_buffer_enable;
	};

	spdif4_rx_idle: spdif4_rx_idle{
		telechips,pins = "gpe-9";
		telechips,pin-function = <0>;
		telechips,output-low = <0>;
	};

	spdif5_tx: spdif5_tx{
		telechips,pins = "gpe-10";
		telechips,pin-function = <3>;
	};

	spdif5_tx_idle: spdif5_tx_idle{
		telechips,pins = "gpe-10";
		telechips,pin-function = <0>;
		telechips,output-low = <0>;
	};

	spdif5_rx: spdif5_rx{
		telechips,pins = "gpe-10";
		telechips,pin-function = <4>;
		telechips,input_buffer_enable;
	};

	spdif5_rx_idle: spdif5_rx_idle{
		telechips,pins = "gpe-10";
		telechips,pin-function = <0>;
		telechips,output-low = <0>;
	};

	spdif6_tx: spdif6_tx{
		telechips,pins = "gpe-15";
		telechips,pin-function = <3>;
	};

	spdif6_tx_idle: spdif6_tx_idle{
		telechips,pins = "gpe-15";
		telechips,pin-function = <0>;
		telechips,output-low = <0>;
	};

	spdif6_rx: spdif6_rx{
		telechips,pins = "gpe-15";
		telechips,pin-function = <4>;
		telechips,input_buffer_enable;
	};

	spdif6_rx_idle: spdif6_rx_idle{
		telechips,pins = "gpe-15";
		telechips,pin-function = <0>;
		telechips,output-low = <0>;
	};

/*****************************************************
* Audio PinCtrl END
******************************************************/
};

&pinctrl {
	m1dai1_bclk {
		telechips,schmitt-input;
	};
	m1dai1_lrck {
		telechips,schmitt-input;
	};
	m1dai1_dai0 {
		telechips,schmitt-input;
	};
	m1dai1_dai1 {
		telechips,schmitt-input;
	};
	m1dai1_dai2 {
		telechips,schmitt-input;
	};
	m1dai1_dai3 {
		telechips,schmitt-input;
	};
	m1dai0_bclk {
		telechips,schmitt-input;
	};
	m1dai0_lrck {
		telechips,schmitt-input;
	};
	m1dai0_dai0 {
		telechips,schmitt-input;
	};
	m1dai0_dai1 {
		telechips,schmitt-input;
	};
	m1dai0_dai2 {
		telechips,schmitt-input;
	};
	m1dai0_dai3 {
		telechips,schmitt-input;
	};
	m0dai1_bclk {
		telechips,schmitt-input;
	};
	m0dai1_lrck {
		telechips,schmitt-input;
	};
	m0dai1_dai0 {
		telechips,schmitt-input;
	};
};

&i2s1 {
	compatible = "telechips,sdr";
	dev-name = "tcc-iq01";
	pinctrl-names = "default", "idle";
	pinctrl-0 = <&m1dai1_bclk &m1dai1_lrck
				&m1dai1_dai0 &m1dai1_dai1
				&m1dai1_dai2 &m1dai1_dai3>;
	pinctrl-1 = <&m1dai1_bclk_idle &m1dai1_lrck_idle
				&m1dai1_dai0_idle &m1dai1_dai1_idle
				&m1dai1_dai2_idle &m1dai1_dai3_idle>;
	status = "okay";
};

&i2s2 {
	compatible = "telechips,sdr";
	dev-name = "tcc-iq23";
	pinctrl-names = "default", "idle";
	pinctrl-0 = <&m1dai0_bclk &m1dai0_lrck
				&m1dai0_dai0 &m1dai0_dai1>;
	pinctrl-1 = <&m1dai0_bclk_idle &m1dai0_lrck_idle
				&m1dai0_dai0_idle &m1dai0_dai1_idle>;
	status = "okay";
};


&i2s4 {
	compatible = "telechips,sdr";
	dev-name = "tcc-hdr-blend";
	pinctrl-names = "default", "idle";
	pinctrl-0 = <&m0dai1_bclk &m0dai1_lrck &m0dai1_dai0>;
	pinctrl-1 = <&m0dai1_bclk_idle &m0dai1_lrck_idle &m0dai1_dai0_idle>;
	status = "okay";
};

&adma1 { //SDR iq01
	status = "disabled";
};

&adma2 { //SDR iq23
	status = "disabled";
};

&adma4 {
	status = "disabled";
};

&audio_chmux{
	compatible = "telechips,audio-chmux-805x";
	dai = <3 1 0 0 1 99 99>;
	// i2s0(3) i2s1(1) i2s2(0) i2s3(0) i2s4(1) i2s5(x) i2s6(x) i2s7(x)
	spdif = <2 99 99 3 99 99 99>;
	// spdif0(2) spdif1(x) spdif2(x) spdif3(3) spdif4(x) spdif5(x) spdif6(x)
	status = "okay";
};

&adma0 { //Main Audio, SPDIF TX
	status = "okay";
};

&adma3 { //BT, SPDIF RX
	status = "okay";
};

&i2s0 {	//Main Audio
	pinctrl-names = "default", "idle";
	pinctrl-0 = <&m1dai3_mclk &m1dai3_bclk &m1dai3_lrck
				&m1dai3_dao0 &m1dai3_dai0
				&m1dai3_dao1 &m1dai3_dai1>;
	pinctrl-1 = <&m1dai3_mclk_idle &m1dai3_bclk_idle &m1dai3_lrck_idle
				&m1dai3_dao0_idle &m1dai3_dai0_idle
				&m1dai3_dao1_idle &m1dai3_dai1_idle>;
	status = "okay";

};

&i2s3 {	//BT
	pinctrl-names = "default", "idle";
	pinctrl-0 = <&m0dai0_bclk &m0dai0_lrck
				&m0dai0_dao0 &m0dai0_dai0>;
	pinctrl-1 = <&m0dai0_bclk_idle &m0dai0_lrck_idle
				&m0dai0_dao0_idle &m0dai0_dai0_idle>;
	status = "okay";

};

&spdif0 {
	pinctrl-names = "default", "idle";
	pinctrl-0 = <&spdif2_tx>;
	pinctrl-1 = <&spdif2_tx_idle>;
	status = "okay";
};

&spdif3 {
	pinctrl-names = "default", "idle";
	pinctrl-0 = <&spdif3_rx>;
	pinctrl-1 = <&spdif3_rx_idle>;
	status = "okay";
};

&dptx_audio {
	audio-input = <2 2 2>;
	data-width = <16 16 16>;
	channels = <2 2 2>;
	clock-frequency = <32000 32000 32000>;
	status = "okay";
};

/*
&asrc0 {
	sync-mode = <1 1 1 1>; // 0:async, 1:sync
	//path-type = <0 0 0 0>; // 0:m2m, 1:m2p, 2:p2m
	path-type = <1 1 1 2>; // 0:m2m, 1:m2p, 2:p2m
	status = "okay";
};

&sound0 {
	compatible = "telechips,asrc-card";
	card-name = "TCC805x EVM Card";
	status = "okay";

	asrc = <&asrc0>;

	telechips,dai-link@0 {
		codec,format = "i2s";

		i2s = <&i2s0>;
		codec = <&ak4601>;
		codec,dai-name = "ak4601-aif1";

		asrc-m2p-pairs = <0 1 2>;
		asrc-p2m-pairs = <3>;

		mclk_div = <16>; // 4,6,8,16
		bclk_ratio = <64>; // 32,48,64fs
		samplerate = <48000>;
		format = <0>; // 0:S16LE, 1:S24LE
		channels = <2>; //2, 4, 6, 8
	};
};
*/

&sound0 {
	compatible = "telechips,snd-card";
	card-name = "TCC805x EVM Card";
	status = "okay";
#ifdef DT_OVERLAY
	overlay_dt;
#endif

	telechips,dai-link@0 {
		stream-name="I2S_0";
		codec,format = "i2s"; // i2s, left_j, right_j
		codec,continuous-clock;
		mclk_div = <16>; // 4,6,8,16
		bclk_ratio = <64>; // 32,48,64fs
		pcm = <&adma0>;
		dai = <&i2s0>;
		codec = <&ak4601>;
		codec,dai-name = "ak4601-aif1";
	};

	telechips,dai-link@1 {
		stream-name="SPDIF_0_TX";
		pcm = <&adma0>;
		dai = <&spdif0>;
		playback-only;
	};

	telechips,dai-link@2 {
		stream-name="SPDIF_1_RX";
		pcm = <&adma3>;
		dai = <&spdif3>;
		capture-only;
	};

	telechips,dai-link@3 {
		stream-name="I2S_3";
		codec,format = "i2s"; // i2s, left_j, right_j
		codec,continuous-clock;
		mclk_div = <16>; // 4,6,8,16
		bclk_ratio = <64>; // 32,48,64fs
		pcm = <&adma3>;
		dai = <&i2s3>;
	};
};
