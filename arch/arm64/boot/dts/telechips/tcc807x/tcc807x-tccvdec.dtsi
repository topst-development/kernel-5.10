// SPDX-License-Identifier: (GPL-2.0-or-later OR MIT)
/*
 * Copyright (C) 2023 Telechips Inc.
 */
/
{
	reserved-memory {
		#address-cells = <2>;
		#size-cells = <2>;
		ranges;	
		tvdec_rmem: tvdec_rmem@0 {
			compatible = "shared-dma-pool";
			no-map;
			reg = <0x0 0x60000000 0x0 0x20000000>;
		};
	};

	vdec_drv0: vdec_drv@0 {
			compatible = "telechips,v4l2_vdec";
			reg = <0x0 0x0 0x0 0x0>;
			memory-region = <&tvdec_rmem>;
			status = "okay";
		};
};