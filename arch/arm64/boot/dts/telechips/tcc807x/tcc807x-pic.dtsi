// SPDX-License-Identifier: (GPL-2.0-or-later OR MIT)
/*
 * Copyright (C) 2023 Telechips Inc.
 */

/ {
	tcc_pic: pic@14600100 {
		compatible = "telechips,tcc807x-pic";
		reg = <0x0 0x14600100 0x0 0x0058>,  /* pol_0_base */
		      <0x0 0x0 0x0 0x0>,
		      <0x0 0x0 0x0 0x0>,
		      <0x0 0x14900080 0x0 0x0058>,  /* strgb_base */
		      <0x0 0x0 0x0 0x0>;
		demarcation = <704>;
		max_irq = <684>;
		have-syscore-ops;
	};
};
