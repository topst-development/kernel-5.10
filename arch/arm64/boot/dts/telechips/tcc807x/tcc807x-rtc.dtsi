// SPDX-License-Identifier: (GPL-2.0-or-later OR MIT)
/*
 * Copyright (C) 2023 Telechips Inc.
 */

#include <dt-bindings/clock/telechips,tcc807x-clks.h>
#include <dt-bindings/interrupt-controller/arm-gic.h>

/ {
	rtc: rtc@0x16480000 {
		compatible = "telechips,rtc";
		reg = <0x0 0x16480000 0x0 0x50>;
		clocks = <&clk_io IOBUS_RTC>;
		interrupts = <GIC_SPI 64 IRQ_TYPE_LEVEL_HIGH>;
		/* Clocksource for RTC, 1: XTAL, 2: OSC */
		rtc_clock = <1>;
	};
};
