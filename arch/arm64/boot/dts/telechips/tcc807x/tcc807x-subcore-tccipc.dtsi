// SPDX-License-Identifier: (GPL-2.0-or-later OR MIT)
/*
 * Copyright (C) Telechips Inc.
 */

/{
	ipc1: tcc_ipc1 {
		compatible = "telechips,tcc_ipc";
		device-name = "tcc_ipc_ap";
		tcc_ipi = <&tcc_ipi_main>;
		status = "okay";
	};
};
