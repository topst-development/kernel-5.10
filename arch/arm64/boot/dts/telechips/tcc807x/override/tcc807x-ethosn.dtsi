// SPDX-License-Identifier: (GPL-2.0-or-later OR MIT)
/*
 * Copyright (C) Telechips Inc.
 */

&ethosn_reserved {
	status = "disabled";
};

&ethosn0 {
	memory-region = <&ethosn_reserved>;
	status = "disabled";
	core0 {
		compatible = "ethosn-core";
		/* iommus = <&smmu_npu 0>; */
		status = "okay";
	};
};
