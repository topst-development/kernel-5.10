// SPDX-License-Identifier: (GPL-2.0-or-later OR MIT)
/*
 * Copyright (C) 2023 Telechips Inc.
 */

/ {
    firmware {
        optee {
            compatible = "linaro,optee-tz";
            method = "smc";
        };
    };
};
