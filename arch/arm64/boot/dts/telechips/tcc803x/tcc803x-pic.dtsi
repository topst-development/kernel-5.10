// SPDX-License-Identifier: (GPL-2.0-or-later OR MIT)
/*
 * Copyright (C) 2023 Telechips Inc.
 */

/ {
	tcc_pic: pic@14100000 {
		compatible = "telechips,tcc803x-pic";
		reg = <0x0 0x141000E0 0x0 0x0018>,  /* pol_0_base */
		      <0x0 0x1460015C 0x0 0x0004>,  /* pol_1_base */
		      <0x0 0x0 0x0 0x0>,            /* cmb_cm4_base */
		      <0x0 0x0 0x0 0x0>,            /* strgb_cm4_base */
		      <0x0 0x14600008 0x0 0x001C>;  /* ca7_irqo_en_base */
		demarcation = <192>;
		max_irq = <196>;
	};
};
