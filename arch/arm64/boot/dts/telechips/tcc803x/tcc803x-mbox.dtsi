// SPDX-License-Identifier: (GPL-2.0-or-later OR MIT)
/*
 * Copyright (C) 2023 Telechips Inc.
 */

#include <dt-bindings/interrupt-controller/arm-gic.h>

/ {
	/* A53 <-> A7S */
	a53_a7s_mbox: mbox@0x17A00000 {
		compatible = "telechips,mailbox-controller-v1";
		reg = <0x0 0x17A00000 0x0 0x100>;
		interrupts = <GIC_SPI 188 IRQ_TYPE_LEVEL_HIGH>;
		#mbox-cells = <1>;
	};

	/* A53 <-> R5 */
	a53_micom_mbox: mbox@0x1BA10000 {
		compatible = "telechips,mailbox-controller-v1";
		reg = <0x0 0x1BA10000 0x0 0x100>;
		interrupts = <GIC_SPI 158 IRQ_TYPE_LEVEL_HIGH>;
		#mbox-cells = <1>;
	};

	/* A53 <-> M4 */
	a53_hsm_mbox: mbox@0x19000000 {
		compatible = "telechips,mailbox-controller-v1";
		reg = <0x0 0x19000000 0x0 0x100>;
		interrupts = <GIC_SPI 42 IRQ_TYPE_LEVEL_HIGH>;
		#mbox-cells = <1>;
	};
};
