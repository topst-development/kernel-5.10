// SPDX-License-Identifier: (GPL-2.0-or-later OR MIT)
/*
 * Copyright (C) 2023 Telechips Inc.
 */

/ {
	cpu_id: cpu-id@14200290 {
		compatible = "telechips,tcc-cpu-id";
		reg = <0x0 0x14200290 0x0 0x4>,
		      <0x0 0x14200298 0x0 0x4>,
		      <0x0 0x1420029C 0x0 0x4>,
		      <0x0 0x14400014 0x0 0x4>;
		status = "okay";
	};
};
