// SPDX-License-Identifier: (GPL-2.0-or-later OR MIT)
/*
 * Copyright (C) 2023 Telechips Inc.
 */

#include <dt-bindings/interrupt-controller/arm-gic.h>

/ {
	sdhc0: sdhc@48000000 {
		compatible = "telechips,tcn100x-sdhci";
		reg = <0x0 0x48000000 0x0 0x100>,
		      <0x0 0x48010000 0x0 0x200>,
		      <0x0 0x0 0x0 0x0> /* dummy */,
		      <0x0 0x480100FC 0x0 0x4>;
		interrupts = <GIC_SPI 329 IRQ_TYPE_LEVEL_HIGH>;
		clocks = <&fbus_smu PERI_SDMMC &clk_hsio HSIO_EMMC_CORE>;
		clock-names = "mmc_fclk", "mmc_hclk";
		max-frequency = <50000000>;
		bus-width = <4>;
		controller-id = <0>;
		status = "disabled";
	};

	vqmmc_emmc: vqmmc_emmc {};
};
