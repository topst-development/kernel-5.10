// SPDX-License-Identifier: (GPL-2.0-or-later OR MIT)
/*
 * Copyright (C) 2023 Telechips Inc.
 */

/ {
	cpu_id: cpu-id@4bbe007c {
		compatible = "telechips,tcc-cpu-id";
		reg = <0x0 0x4bbe007c 0x0 0x4>,
		      <0x0 0x4bbe0084 0x0 0x4>,
		      <0x0 0x4bbe0088 0x0 0x4>,
		      <0x0 0x4b200100 0x0 0x20>;
		status = "okay";
	};
};
