// SPDX-License-Identifier: (GPL-2.0-or-later OR MIT)
/*
 * Copyright (C) 2023 Telechips Inc.
 */

#include <dt-bindings/board/telechips.h>

#ifndef DT_OVERLAY
#include "tcc750x.dts"
#endif

/ {
	model = "Telechips TCC7500 LPD4X321";
	board-id = <BOARD_ID_TCC7500_EVB>;
	board-rev = <0x0>;
};

#include "override/tcc750x-dma.dtsi"
#include "override/tcc750x-vpu.dtsi"
#include "override/tcc7500-cpu.dtsi"
#include "override/tcc7500-lpd4x321-gpio.dtsi"
#include "override/tcc7500-lpd4x321-uart.dtsi"
#include "override/tcc7500-lpd4x321-mmc.dtsi"
#include "override/tcc7500-lpd4x321-i2c.dtsi"
#include "override/tcc7500-lpd4x321-spi.dtsi"
#include "override/tcc7500-lpd4x321-gmac.dtsi"
#include "override/tcc7500-lpd4x321-pcie-ep.dtsi"
#include "override/tcc7500-linux-display.dtsi"
#include "override/tcc7500-lpd4x321-camera.dtsi"
#include "override/tcc7500-lpd4x321-npu.dtsi"
#include "override/tcc750x-visionprotocol-reserved-memory.dtsi"
