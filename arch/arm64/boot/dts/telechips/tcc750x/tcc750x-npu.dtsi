// SPDX-License-Identifier: (GPL-2.0-or-later OR MIT)
/*
 * Copyright (C) 2023 Telechips Inc.
 */
#include <dt-bindings/clock/telechips,tcc750x-clks.h>

/ {
	aliases: aliases {
		npu0 = &npu0;
		npu1 = &npu1;
	};

	npu0: npu@11000000 {
		compatible = "openedge,npu";
		reg = <0x0 0x11000000 0x0 0x400>;
		interrupts = <GIC_SPI 153 IRQ_TYPE_LEVEL_HIGH>;
		clocks = <&fbus_npu FBUS_NPU_0_ACLK &fbus_npu FBUS_NPU_PCLK
				&fbus_npu FBUS_NPU_0_CCLK &fbus_npu FBUS_NPU_0_CPUCLK >;
		clock-names = "npubus_aclk", "npubus_pclk", "npubus_cclk", "npubus_cpu";
		status = "disabled";
		/* TODO: use reserved memory */
		// memory-region = <&pmap_npu0>;
	};

	npu1: npu@11000400 {
		compatible = "openedge,npu";
		reg = <0x0 0x11000400 0x0 0x400>;
		interrupts = <GIC_SPI 154 IRQ_TYPE_LEVEL_HIGH>;
		clocks = <&fbus_npu FBUS_NPU_1_ACLK &fbus_npu FBUS_NPU_PCLK
				&fbus_npu FBUS_NPU_1_CCLK &fbus_npu FBUS_NPU_1_CPUCLK >;
		clock-names = "npubus_aclk", "npubus_pclk", "npubus_cclk", "npubus_cpu";
		status = "disabled";
		/* TODO: use reserved memory */
		// memory-region = <&pmap_npu1>;
	};
};
