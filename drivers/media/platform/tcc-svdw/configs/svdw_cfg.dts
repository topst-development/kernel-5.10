/dts-v1/;
/ {
    CH0 {
        params = <0x138 0x00020208
                  0x238 0x00020208
                  0x338 0x00020208
                  0x438 0x00020208
                  0x13c 0x0c280c00
                  0x140 0xf8202800
                  0x23c 0x0c280c00
                  0x240 0xf8202800
                  0x33c 0x0c280c00
                  0x340 0xf8202800
                  0x43c 0x0c280c00
                  0x440 0xf8202800
                  0x148 0x3043
                  0x14c 0xfd6c
                  0x150 0x5060
                  0x154 0x3031
                  0x158 0x2d6b
                  0x15c 0xf6e58
                  0x160 0x2f92
                  0x164 0xffc6a
                  0x168 0x0d3
                  0x16c 0x08FCB
                  0x170 0xFF948
                  0x174 0xFE19F
                  0x178 0x5FE
                  0x248 0x3043
                  0x24c 0xfd6c
                  0x250 0x5060
                  0x254 0x3031
                  0x258 0x2d6b
                  0x25c 0xF6E58
                  0x260 0x2f92
                  0x264 0xffc6a
                  0x268 0x0d3
                  0x26c 0x08FCB
                  0x270 0xFF948
                  0x274 0xFE19F
                  0x278 0x5FE
                  0x348 0x3043
                  0x34c 0xfd6c
                  0x350 0x5060
                  0x354 0x3031
                  0x358 0x2d6b
                  0x35c 0xF6E58
                  0x360 0x2f92
                  0x364 0xffc6a
                  0x368 0x0d3
                  0x36c 0x08FCB
                  0x370 0xFF948
                  0x374 0xFE19F
                  0x378 0x5FE
                  0x448 0x3043
                  0x44c 0xfd6c
                  0x450 0x5060
                  0x454 0x3031
                  0x458 0x2d6b
                  0x45c 0xF6E58
                  0x460 0x2f92
                  0x464 0xffc6a
                  0x468 0x0d3
                  0x46c 0x08FCB
                  0x470 0xFF948
                  0x474 0xFE19F
                  0x478 0x5FE
                  0x17c 0xFE798
                  0x180 0xFE7C1
                  0x184 0x4EC1
                  0x188 0x1B22
                  0x18c 0xFDAB5
                  0x190 0x0D4F
                  0x194 0x56C
                  0x198 0xFEC84
                  0x19c 0xFEFF1
                  0x1a0 0x260F
                  0x1a4 0x4EC9
                  0x1a8 0xFEC11
                  0x1ac 0xFF21D
                  0x1b0 0x0C51
                  0x1b4 0x09A1
                  0x1b8 0xFF78A
                  0x27c 0xFE1C2
                  0x280 0xFE917
                  0x284 0x2C76
                  0x288 0x5C15
                  0x28c 0xFB6EB
                  0x290 0x1D69
                  0x294 0x0B89
                  0x298 0xFDF94
                  0x29c 0xFF643
                  0x2a0 0x1637
                  0x2a4 0x1ABD
                  0x2a8 0xFE9A6
                  0x2ac 0xFF8F8
                  0x2b0 0x0D67
                  0x2b4 0x570
                  0x2b8 0xFF8E0
                  0x37c 0xFE798
                  0x380 0xFE7C1
                  0x384 0x4EC1
                  0x388 0x1B22
                  0x38c 0xFDAB5
                  0x390 0x0D4F
                  0x394 0x56C
                  0x398 0xFEC84
                  0x39c 0xFEFF1
                  0x3a0 0x260F
                  0x3a4 0x4EC9
                  0x3a8 0xFEC11
                  0x3ac 0xFF21D
                  0x3b0 0x0C51
                  0x3b4 0x09A1
                  0x3b8 0xFF78A
                  0x47c 0xFE1C2
                  0x480 0xFE917
                  0x484 0x2C76
                  0x488 0x5C15
                  0x48c 0xFB6EB
                  0x490 0x1D69
                  0x494 0x0B89
                  0x498 0xFDF94
                  0x49c 0xFF643
                  0x4a0 0x1637
                  0x4a4 0x1ABD
                  0x4a8 0xFE9A6
                  0x4ac 0xFF8F8
                  0x4b0 0x0D67
                  0x4b4 0x570
                  0x4b8 0xFF8E0>;
    };
};