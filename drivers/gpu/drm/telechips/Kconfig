## drivers/pci/controller/dwc/telechips/Kconfig
```kconfig
# SPDX-License-Identifier: GPL-2.0-or-later
#
# Copyright (C) 2023 Telechips Inc.
#
#
#

config PCIE_TELECHIPS
	tristate "Telechips PCIe controller"
	depends on ARCH_TELECHIPS
	select PHY_SEC14LPP_PCIE if ARCH_TCC803X
	select PHY_SEC08LPP_PCIE if ARCH_TCC807X
	select PHY_SS14LPP_X1NS_PCIE if (ARCH_TCC805X || ARCH_TCC750X)
	select PHY_SS14LPP_X2NS_PCIE if ARCH_TCN100X
	help
	  This selects the TCC PCIe controller/PHY support.
	  Select this if you have a PCIe interface on platform.
	  The PCI controller on TCC is based on DesignWare hardware
	  and therefore the driver re-uses the DesignWare core functions to
	  implement the driver.

config PCIE_TELECHIPS_HOST
	bool "Telechips PCIe controller Host mode"
	depends on PCIE_TELECHIPS
	depends on PCI_MSI_IRQ_DOMAIN
	select PCIE_DW_HOST
	help
	  Enables support for the PCIe controller in the Telechips SoC to work
	  in host mode. This controller can work either as EP or RC.
	  This uses the DesignWare core.

config PCIE_TELECHIPS_EP
	bool "Telechips PCIe controller Endpoint mode"
	depends on PCIE_TELECHIPS && PCI_ENDPOINT && !ARCH_TCC803X
	depends on PCI_MSI_IRQ_DOMAIN
	select PCIE_DW_EP
	help
	  Enables support for the PCIe controller in the Telechips SoC to work
	  in endpoint mode. This controller can work either as EP or RC.
	  This uses the DesignWare core.
```

## drivers/phy/telechips/Kconfig
```kconfig
# SPDX-License-Identifier: GPL-2.0-or-later
#
# Copyright (C) 2023 Telechips Inc.
#

config PHY_SEC08LPP_PCIE
	tristate "Telechips Dolphin5 PCIe PHY Driver"
	depends on ARCH_TCC807X || COMPILE_TEST
	select GENERIC_PHY
	help
	  Enable this to support the PCIe PHY on Dolphin5 SoCs.

config PHY_SEC14LPP_PCIE
	tristate "Telechips Dolphin3s PCIe PHY Driver"
	depends on ARCH_TCC803X
	select GENERIC_PHY
	help
	  Enable this to support the PCIe PHY on Dolphin SoCs.

config PHY_SS14LPP_X1NS_PCIE
	tristate "Telechips Dolphin3 PCIe PHY Driver"
	depends on (ARCH_TCC805X || ARCH_TCC750X) || COMPILE_TEST
	select GENERIC_PHY
	help
	  Enable this to support the PCIe PHY on Dolphin SoCs.

config PHY_SS14LPP_X2NS_PCIE
	tristate "Telechips Designware PCIe PHY x2 lane Driver"
	depends on ARCH_TCN100X || COMPILE_TEST
	select GENERIC_PHY
	help
	  Enable this to support the PCIe PHY on Axon SoCs.
```

## drivers/soc/telechips/Kconfig
```kconfig
# SPDX-License-Identifier: GPL-2.0-or-later
#
# Copyright (C) 2023 Telechips Inc.

menuconfig SOC_TELECHIPS
	bool "Telechips SOC drivers support"
	depends on ARCH_TELECHIPS

if SOC_TELECHIPS

config HAVE_TELECHIPS_SIP_SERVICE
	bool

config HAVE_TELECHIPS_PLAT_CHIPINFO
	bool

config TELECHIPS_BOOTSTAGE
	tristate "Telechips bootstage driver"
	depends on PROC_FS
	depends on ARCH_TCC750X || ARCH_TCC803X || ARCH_TCC805X || ARCH_TCC807X
	default y
	help
	  Select this option to enable Telechips bootstage driver.

	  Telechips bootstage driver offers procfs to show boot time stamps
	  from power on to kernel boot for supported Telechips SoCs.

	  If unsure, say Y.

config TELECHIPS_CHIPINFO
	tristate "Telechips chipinfo driver"
	depends on HAVE_TELECHIPS_SIP_SERVICE || HAVE_TELECHIPS_PLAT_CHIPINFO
	default y
	help
	  Select this option to enable Telechips chipinfo driver.

	  Telechips chipinfo driver offers procfs to show information related
	  related to chip such as revision number or boot such as boot config
	  selection.

	  If unsure, say Y.

config TELECHIPS_PIC
	tristate "Telechips programmable interrupt controller driver"
	default y
	help
	  Select this option to enable Telechips programmable interrupt controller driver.

config TELECHIPS_TIMER
	tristate "Telechips timer driver"
	default y
	help
	  Select this option to enable Telechips timer driver.
	  It supports 16/20-bit timer for Telechips SoCs.

config PROC_RESERVED_MEM
	tristate "/proc/reserved_mem support"
	depends on OF_RESERVED_MEM
	depends on PROC_FS
	default y
	help
	  Select this option to enable /proc/reserved_mem support.

	  /proc/reserved_mem shows the memory map of entire reserved memory
	  registered by device tree.

	  If unsure, say Y.

endif # SOC_TELECHIPS
```

## drivers/thermal/telechips/Kconfig
```kconfig
# SPDX-License-Identifier: GPL-2.0-or-later
#
# Copyright (C) 2023 Telechips Inc.
#
config TELECHIPS_THERMAL
        depends on OF
        tristate "Temperature sensor on Telechips SoCs"
        help
          If you say yes here you get support for Telechips SoC.

config ARM_TELECHIPS_MP_CPUFREQ
        bool "Telechips Thermal driver driving by MP condition."
        depends on TCC_THERMAL
        default n
        help
          If you say yes here you get support for MP thermal policy.

config TELECHIPS_THERMAL_IRQ
       bool "Telechips Thermal driver IRQ check."
       depends on TCC_THERMAL
       default n
       help
         If you say yes here you get support for Thermal driver IRQ handler.

config TELECHIPS_GPU_THERMAL_SUPPORT
        bool "Telechips thermal driver for GPU"
        depends on TCC_THERMAL && ARCH_TCC805X
        default n
        help
          If you say yes here you get support for GPU Thermal driver.

config TELECHIPS_TEM1459
       bool "Thermal Sensor IP name - TEM1459"
       depends on (ARCH_TCC803X || ARCH_TCC899X || ARCH_TCC802X || ARCH_TCC897X)
       default y
       help
         Name of Thermal Sensor IP.
```

## drivers/video/fbdev/telechips/Kconfig
```kconfig
# SPDX-License-Identifier: GPL-2.0-or-later
#
# Copyright (C) Telechips Inc.
#

if ARCH_TCC807X
source "drivers/video/fbdev/telechips/vioc_tcc807x/Kconfig"
endif
if !ARCH_TCC807X
source "drivers/video/fbdev/telechips/vioc/Kconfig"
endif

source "drivers/video/fbdev/telechips/panel/Kconfig"

config TELECHIPS_SIMPLE_FB
	tristate "Telechips Simple VIOC Frame buffer support"
	depends on FB && ARCH_TELECHIPS && TELECHIPS_VIOC_LOW_API
	select FB_CFB_FILLRECT
	select FB_CFB_COPYAREA
	select FB_CFB_IMAGEBLIT
	default n
	help
		This is Simple Frame buffer driver for Telechips Soc.
		It is complex and difficult to use TVFB because additional functions other
		than UI control function are provided. Therefore, in this frame buffer driver,
		unnecessary functions other than the UI control function are removed.

config TELECHIPS_OVERLAY
	tristate "Overlay driver for camera/video"
	depends on ARCH_TELECHIPS
	default n
	help
		This is the Overlay driver for video or camera output.

# config TELECHIPS_VOUT_BOOTING_ANIMATION
#	bool"support vout dual display for booting animation (only 3840x720)"
#	depends on (!TELECHIPS_DUAL_DISPLAY)
#	default n
#	help
#		This is support vout dual display for booting animation

config VIDEO_DISPLAY_DEINTERLACE_MODE
	bool "Support Interlaced Video"
	depends on VIOC_DEINTERLACER && !(ARCH_TCC750X)
	default y
	help
		It makes the interlaced video can be displayed smoothly.

if VIDEO_DISPLAY_DEINTERLACE_MODE
config VIOC_VIQE
	tristate "Telechips VIQE interface APIs driver"
	default n
	help
		Telechips VIQE interface APIs module.

config TELECHIPS_VIQE
	tristate "Telechips VIQE M2M driver"
	depends on VIOC_VIQE
	default n
	help
		Telechips VIQE De-interlacing M2M (Memory-to-memory) driver.
endif

config VIDEO_DISPLAY_BY_VSYNC_INT
	tristate "Displaying video frame by hw vsync interrupt"
	default n
	help
		Video frame is displayed by hw vsync interrupt.

config LCD_VIDEO_DISPLAY_BY_VSYNC_INT
	bool "LCD display video by hw vsync interrupt"
	depends on VIDEO_DISPLAY_BY_VSYNC_INT
	default n
	help
		It makes LCD use on-the-fly and vsync routine.

config VIDEO_DISPLAY_SWAP_VPU_FRAME
	bool "SWAP VPU FRAME"
	depends on VIDEO_DISPLAY_BY_VSYNC_INT
	default n
```

## drivers/video/fbdev/telechips/panel/Kconfig
```kconfig
# SPDX-License-Identifier: GPL-2.0-or-later
#
# Copyright (C) Telechips Inc.

menu "LCD panels for TELECHISP SIMPLE FB"
	depends on TELECHIPS_SIMPLE_FB

config TELECHIPS_FB_LVDS_PANEL
	bool "LVDS panel drivers"
	depends on OF && TELECHIPS_SIMPLE_FB && ARCH_TCC805X
	default y if ARCH_TCC805X
	select VIDEOMODE_HELPERS
	help
	  This driver supports LVDS panels that don't require device-specific
	  handling of power supplies or control signals.

config TELECHIPS_FB_DSI_PANEL
	bool "DSI panel drivers"
	depends on OF && TELECHIPS_SIMPLE_FB && ARCH_TCC807X
	default y if ARCH_TCC807X
	select VIDEOMODE_HELPERS
	help
	  This driver supports DSI panels that don't require device-specific
	  handling of power supplies or control signals.

config TELECHIPS_FB_CTRL_BACKLIGHT
	tristate "binding TCC LVDS & DP backlight driver(gpio, pwm ...)"
	depends on OF && FB_NEW && (ARCH_TCC805X || ARCH_TCC807X)
	help
	  This driver supports to bind FB_PANEL_XXX_TCC and backlight driver.

endmenu
```

## drivers/video/fbdev/telechips/vioc/Kconfig
```kconfig
# SPDX-License-Identifier: GPL-2.0-or-later
#
# Copyright (C) Telechips Inc.
#

config TELECHIPS_VIOC_LOW_API
	tristate "Telechips VIOC LOW APIs"
	depends on ARCH_TELECHIPS
	default n
	help
		If true, it supports low api to control VIOC blocks.

if TELECHIPS_VIOC_LOW_API
config VIOC_OUTPUT_CONFIG
	bool "Enable De-interlacer (VIQE and S_Deintl)"
	depends on !(ARCH_TCC750X || ARCH_TCC805X)
	default y
	help
		TELECHIPS Output configuration register.

config VIOC_DEINTERLACER
	bool "Enable De-interlacer (VIQE and S_Deintl)"
	depends on !(ARCH_TCC750X)
	default y
	help
		TELECHIPS De-interlacer VIQE and Simple De-interlacer.

config VIOC_MAP_DECOMP
	bool "VIOC MAP Decompressor support for HEVC"
	depends on (ARCH_TCC803X || ARCH_TCC805X)
	default y
	help
		TELECHIPS VIOC MAP CONVERTER Block.
		Decompress HEVC compressed data.

config VIOC_AFBCDEC
	bool "Enable AFBC decoder"
	depends on (ARCH_TCC803X) && MALI_MIDGARD
	default n
	help
		TELECHIPS AFBC Decoder

config VIOC_PVRIC_FBDC
	bool "Enable PVRIC_FBDC"
	depends on (ARCH_TCC805X) && POWERVR_ROGUE
	default n
	help
		TELECHIPS PVRIC Framebuffer decompressor

config VIOC_G2D
	bool "Enable Graphic 2D"
	depends on (ARCH_TCC803X || ARCH_TCC805X) && !TELECHIPS_DUAL_DISPLAY
	default y
	help
		TELECHIPS Graphic 2D controller
endif
```

## drivers/video/fbdev/telechips/vioc_tcc807x/Kconfig
```kconfig
# SPDX-License-Identifier: GPL-2.0-only
#
# Copyright (C) Telechips Inc.
#

config TELECHIPS_VIOC_LOW_API
	tristate "Telechips VIOC LOW APIs"
	depends on ARCH_TELECHIPS
	default n
	help
		If true, it supports low api to control VIOC blocks.

if TELECHIPS_VIOC_LOW_API
config VIOC_DEINTERLACER
	bool "Enable De-interlacer (VIQE and S_Deintl)"
	depends on !(ARCH_TCC750X)
	default y
	help
		TELECHIPS De-interlacer VIQE and Simple De-interlacer.

config VIOC_MAP_DECOMP
	bool "VIOC MAP Decompressor support for HEVC"
	depends on ARCH_TCC807X
	default y
	help
		TELECHIPS VIOC MAP CONVERTER Block.
		Decompress HEVC compressed data.

config VIOC_AFBCDEC
	bool "Enable AFBC decoder"
	depends on (ARCH_TCC807X) && MALI_MIDGARD
	default n
	help
		TELECHIPS AFBC Decoder

config VIOC_G2D
	bool "Enable Graphic 2D"
	depends on (ARCH_TCC807X) && !TELECHIPS_DUAL_DISPLAY
	default y
	help
		TELECHIPS Graphic 2D controller
endif
```

## sound/soc/telechips/Kconfig
```kconfig
# SPDX-License-Identifier: GPL-2.0-or-later
#
# Copyright (C) 2023 Telechips Inc.

menu "SoC Audio for Telechips CPUs"

comment "SoC Audio options for TCC CPUs:"

config SND_SOC_TELECHIPS
	tristate "ASoC for Telechips"
	select SND_SOC_TELECHIPS_AUDIO_CHMUX if ARCH_TCC803X != n
	select SND_SOC_TELECHIPS_AUDIO_CHMUX if ARCH_TCC805X != n
	depends on ( ARCH_TCC803X || ARCH_TCC805X )  && SND_SOC
	default y
	help
		Telechips I2S, SPDIF, CDIF Driver

config SND_SOC_TELECHIPS_AUDIO_CHMUX
	tristate
	depends on SND_SOC_TELECHIPS
	help
		Telechips ASoC CHMUX Driver

config SND_SOC_TELECHIPS_CARD
	tristate "ASoC CARD for Telechips"
	depends on SND_SOC_TELECHIPS
	default y
	help
		Telechips ASoC Card Driver

source "sound/soc/telechips/asrc/Kconfig"
source "sound/soc/telechips/dptx_audio/Kconfig"
endmenu
```

## sound/soc/telechips/dptx_audio/Kconfig
```kconfig
# SPDX-License-Identifier: GPL-2.0-or-later
#
# Copyright (C) 2023 Telechips Inc.

config TELECHIPS_DPTX_AUDIO
	tristate "Telechips DPTX V1_4 Audio Link Driver"
	depends on ARCH_TCC805X && SND_SOC_TELECHIPS && TELECHIPS_DP_DRIVER_V1_4
	default n
	select SND_SOC_HDMI_CODEC
	help
		Telechips DisplayPort v1.4 Tx Audio Link Driver
```

## sound/soc/telechips_dpcm/Kconfig
```kconfig
# SPDX-License-Identifier: GPL-2.0-or-later
#
# Copyright (C) 2023 Telechips Inc.

menu "SoC Audio for Telechips CPUs"

comment "SoC Audio options for TCC CPUs:"

config SND_SOC_TELECHIPS
	tristate "ASoC for Telechips"
	select SND_SOC_TELECHIPS_AUDIO_CHMUX if ARCH_TCC807X != n
	depends on ( ARCH_TCC807X ) && SND_SOC
	default y
	help
		Telechips I2S, SPDIF, CDIF Driver

config SND_SOC_TELECHIPS_AUDIO_CHMUX
	tristate
	depends on SND_SOC_TELECHIPS
	help
		Telechips ASoC CHMUX Driver

config SND_SOC_TELECHIPS_CARD
	tristate "ASoC CARD for Telechips"
	depends on SND_SOC_TELECHIPS
	default y
	help
		Telechips ASoC Card Driver

config SND_SOC_TELECHIPS_EXTENDED_TBD
	tristate "For Telechips developers only for verifying new audio IPs"
	depends on SND_SOC_TELECHIPS
	default n
	help
		Telechips ASoC Card Driver
source "sound/soc/telechips_dpcm/dptx_audio/Kconfig"
endmenu
```
