## drivers/gpu/drm/telechips/Kconfig
```kconfig
config DRM_TELECHIPS
	tristate "DRM Support for Telechips SoC Series"
	depends on OF && DRM && ARCH_TELECHIPS
	default n
	select DRM_KMS_HELPER
	select VIDEOMODE_HELPERS
	help
		Choose this option if you want used DRM for Telechips SoC
		chipset. This config is mandatory to using DRM driver for
		Telechips SoC.

if DRM_TELECHIPS
config DRM_TELECIHPS_CTRL_CHROMAKEY
	bool "DRM controls chromakey on planes"
	depends on ARCH_TCC805X && DRM_TELECHIPS_VIOC
	default n
	help
		If this config is select then TCCDRM can controls chroma-key of
		WMIX.
		Note:
		Be careful with the overlay prioroty when using this function.

config DRM_TELECHIPS_SKIP_RESTORE_FBDEV
	bool "DRM skips function to restores fbdev"
	default y
	help
		DRM skips function to restores fbdev.
		Normally, at runtime drivers should restore the fbdev console
		by calling drm_fb_helper_restore_fbdev_mode_unlocked() from
		their &drm_driver.lastclosecallback. This ensures that the user
		isn't greeted with a black screen when e.g. X dies.
		But, If you don't need this function, please set this config to
		y then TCCDRM does not call
		rm_fb_helper_restore_fbdev_mode_unlocked when
		&drm_driver.lastclosecallback is called.

comment "CRTCs"
config DRM_TELECHIPS_VIOC
	tristate "Telechips drm vioc driver"
	default n
	help
		This option enables telechisp drm vioc driver.
		This driver controls planes and crtcs for Telechips SoC
		chipset.

config DRM_TELECHIPS_KEEP_LOGO
	bool "DRM TELECHIPS KEEP LOGO"
	default y
	help
		If this config is selected to y, DRM driver skips process that
		fills its plane with block color when it is binded.
		This is a function to maintain the kernel-logo output by Legacy
		FBDev. It should be used only when a panel with a fixed resolution
		such as LVDS is used. If you use HDMI or DP, this config is not
		available because the output resolution of LCD panel may change
		depending on the connected device.
		However, if you use HDMI or DP as a fixed resolution such as
		LVDS panel, this config is available.

config DRM_TELECHIPS_LCD
	bool "Telechips Primary CRTC"
	select DRM_TELECHIPS_VIOC
	default n
	help
		This option enables Primary CRTC.
		Note:
		When using multiple display device, this CRTC is set as the
		primary CRTC.


config DRM_TELECHIPS_EXT
	bool "Telechips Second CRTC"
	select DRM_TELECHIPS_VIOC
	default n
	help
		This option enables Second CRTC.
		Note:
		- if used alone, it becomes the primary CRTC.
		- If used with DRM_TELECHIPS_LCD, this will set as the second CRTC.

config DRM_TELECHIPS_THIRD
	bool "Telechips third display"
	select DRM_TELECHIPS_VIOC
	depends on (ARCH_TCC803X || ARCH_TCC805X || ARCH_TCC807X)
	default n
	help
		This option enables Third CRTC.
		Note:
		- if used alone, it becomes the primary CRTC.
		- If used with DRM_TELECHIPS_LCD or DRM_TELECHIPS_EXT, this will set as the second CRTC.
		- If used with DRM_TELECHIPS_LCD and DRM_TELECHIPS_EXT, this will set as the third CRTC.

config DRM_TELECHIPS_FOURTH
	bool "Telechips fourth display"
	select DRM_TELECHIPS_VIOC
	depends on (ARCH_TCC803X || ARCH_TCC805X || ARCH_TCC807X)
	default n
	help
		This option enables Fourth CRTC.
		Note:
		- if used alone, it becomes the primary CRTC.
		- If used with one of the DRM_TELECHIPS_LCD, DRM_TELECHIPS_EXT or DRM_TELECHIPS_THIRD, this will set as the Second CRTC.
		- If used with DRM_TELECHIPS_LCD and DRM_TELECHIPS_EXT, this will set as the Third CRTC.
		- If used with DRM_TELECHIPS_LCD and DRM_TELECHIPS_THIRD, this will set as the Third CRTC.
		- If used with DRM_TELECHIPS_EXT and DRM_TELECHIPS_THIRD, this will set as the Third CRTC.
		- If used with DRM_TELECHIPS_LCD, DRM_TELECHIPS_EXT and DRM_TELECHIPS_THIRD, this will set as the Fourth CRTC.

config DRM_TELECHIPS_SCREEN_SHARE
	tristate "Telechips Screen shared CRTC"
	depends on DRM_TELECHIPS && TELECHIPS_SCREEN_SHARE
	default n
	help
			Choose this option if you want to use Screen shared function.
			Note:
			This config provides virtual CRTC, which is used when
			the main core and sub-core share image data.

comment "Encoders and Bridges"

config DRM_TELECHIPS_DUMMY_DEV
	tristate "Telechips drm dummy display device driver"
	default n
	help
		This option enables telechisp drm dummy display device driver.
		This driver is used when there is no display device.
		For example, It can be used with crtc of screen-share.

config DRM_TELECHIPS_LVDS
	tristate "Telechips drm lvds device driver"
	depends on ARCH_TCC805X
	default n
	help
		This option enables telechisp drm lvds driver.
		This driver controls lvds ip.

config DRM_TELECHIPS_DP
	tristate "Telechips drm display port driver"
	depends on (ARCH_TCC805X || ARCH_TCC807X) && TELECHIPS_DP_DRIVER_V1_4
	default n
	help
		This option enables telechisp drm display port driver.
		This driver controls display port ip.
		chipset.

config DRM_TELECHIPS_DSI
	tristate "Telechips drm dsi driver"
	depends on (ARCH_TCC807X) && (TELECHIPS_DSI_DRIVER_V2)
	help
		This option enables telechisp drm dsi driver.
		This driver controls dsi ip.
		chipset.
endif

#
# Debugging messages
#
menuconfig DRM_DRV_DEBUG
	bool "DRM Debugging messages (DEVELOPMENT)"
	depends on DRM_TELECHIPS
	help
		Choose this option if you want to use debugging messages (DEVELOPMENT).
		You can choice various debugging messages.
		Kernel debugging level is 'KERN_DEBUG <7>'. (use "dmesg -n 8")

if DRM_DRV_DEBUG
config DRM_UT_CORE
	bool "DRM core messages"
	help
		Choose this option if you want to enable DRM core
		debugging messages.
		Kernel debugging level is 'KERN_DEBUG <7>'. (use "dmesg -n 8")
		Note:
		This config is optional.

config DRM_UT_DRIVER
	bool "DRM driver messages"
	help
		Choose this option if you want to enable DRM driver
		debugging messages.
		Kernel debugging level is 'KERN_DEBUG <7>'. (use "dmesg -n 8")
		Note:
		This config is optional.

config DRM_UT_KMS
	bool "DRM KMS messages"
	help
		Choose this option if you want to enable DRM KMS
		debugging messages.
		Kernel debugging level is 'KERN_DEBUG <7>'. (use "dmesg -n 8")
		Note:
		This config is optional.

config DRM_UT_PRIME
	bool "DRM PRIME messages"
	help
		Choose this option if you want to enable DRM PRIME
		debugging messages.
		Kernel debugging level is 'KERN_DEBUG <7>'. (use "dmesg -n 8")
		Note:
		This config is optional.

endif
```

## drivers/gpu/imgtec/tcc_9xtp/Kconfig
```kconfig
config POWERVR_TCC9XTP
	bool "PowerVR Telechips support"
	default y
	depends on POWERVR_ROGUE
	depends on ARCH_TELECHIPS


config PVR_TCC9XTP_DFS_SUPPORT
	bool "PowerVR Telechips DFS (Dynamic Frequency Scaling) support"
	default n
	depends on POWERVR_TCC9XTP
```

## drivers/input/tc_touch_share/Kconfig
```kconfig
menuconfig TELECHIPS_TOUCH_SHARE
	bool "Telechips Touch Share"
	default n
	help
		The Share Touch between Main-core and Sub-core.
		When this option is activated, the RECEIVE and BRIDGE menus are created
		you must select the CONFIG suitable for the core
		Main-Core - TELECHIPS_TOUCH_BRIDGE / Sub-Core - TELECHIPS_TOUCH_RECEIVE

if TELECHIPS_TOUCH_SHARE

choice
	prompt "Telechips Touch Share Driver Select"
	default TELECHIPS_TOUCH_RECEIVE if (TCC805X_CA53Q || TCC803X_CA7S || TCC807X_CA55_SUB)
	default TELECHIPS_TOUCH_BRIDGE
	help
		This options touch share driver select.//

		Telechips Touch Bridge shares touch data to other core.
		Touch Receive receives touch data from Touch Bridge
		and generates touch event.

config TELECHIPS_TOUCH_BRIDGE
	tristate "Telechips Touch Bridge Driver"
	depends on TCC_IPI_PROTOCOL
	help
		This driver acts as an input handler
		It sends touch data to the Sub-core through the mbox.
		In order for this driver to work, the touch driver must be registered.
		Because it operates Mbox communication and touch data,
		It has a dependency on the touch driver and tcc multi mailbox driver

config TELECHIPS_TOUCH_RECEIVE
	tristate "Telechips Touch Receiver Driver"
	depends on TCC_IPI_PROTOCOL
	help
		This driver generates touch data of Main-core.
		When the driver is registered, the input device and sysfs are created.
		Controls the transmission of touches based on the state of the sysfs.
		The name of sysfs is touch_state.

endchoice

config TELECHIPS_MULTI_TOUCH_SHARE
	bool "Support Multi Touch"
	depends on TELECHIPS_TOUCH_SHARE
	default y
	help
		The Share Touch can support multi touch.
		If you want to support multi touch in Share Touch, 
		you must select the CONFIG TELECHIPS_MULTI_TOUCH_SHARE at main-core and sub-core

endif
```

## drivers/media/platform/tcc-camss/Kconfig
```kconfig
# SPDX-License-Identifier: GPL-2.0
#
# Copyright 2020-2022 Telechips Inc.
#
config TCC_CAP_MEDIA
	tristate "Telechips Capture Media Controller"
	default n
	depends on MEDIA_CONTROLLER && VIDEO_V4L2_SUBDEV_API
	help
	  Say Y here to enable Telechips Capture Media Controller
	  for Telechips SoC.
```

## drivers/media/platform/tcc-idi2axi/Kconfig
```kconfig
# SPDX-License-Identifier: GPL-2.0
#
# Copyright 2020-2022 Telechips Inc.
#
config VIDEO_TCC_IDI2AXI
	tristate "Telechips IDI2AXI Driver"
	depends on ARCH_TCC750X
	depends on VIDEO_V4L2 && OF && HAS_DMA
	default n
	select DMA_DECLARE_COHERENT
	select V4L2_FWNODE
	select VIDEOBUF2_DMA_CONTIG
	select VIDEO_V4L2_SUBDEV_API
	help
	Support v4l2 capture interface

	Note that the driver is supported on the following chipsets.
	- tcc750x
```

## drivers/media/platform/tcc-isp/Kconfig
```kconfig
# SPDX-License-Identifier: GPL-2.0-or-later
#
# Copyright (C) Telechips Inc.
#
config TCC_ISP
	tristate "Telechips ISP driver"
	default n
	depends on ARCH_TCC805X || ARCH_TCC750X || ARCH_TCC807X
	depends on VIDEO_V4L2 && VIDEO_V4L2_SUBDEV_API
	select V4L2_FWNODE
	help
	  Say Y here to enable ISP (Image Signal Processor) for
	  Telechips SoC.

	  Supported format
	  Input: Bayer RGB (RAW) 10/12/14 bits.
	  Output: YUV422 (16 bits), YUV444 (24 bits), RGB (24 bits)
```

## drivers/media/platform/tcc-mipi-csi2/Kconfig
```kconfig
# SPDX-License-Identifier: GPL-2.0-or-later
#
# Copyright (C) Telechips Inc.
#
config TCC_MIPI_CSI2
	tristate "Telechips MIPI CSI-2 driver"
	default n
	depends on ARCH_TCC803X || ARCH_TCC805X || ARCH_TCC750X || ARCH_TCC807X
	depends on VIDEO_V4L2 && VIDEO_V4L2_SUBDEV_API
	select V4L2_FWNODE
	help
	  This is a V4L2 driver for TCC803X and TCC805X SoC MIPI-CSI2
	  receiver devices.

	  Say Y here to enable MIPI-CSI2 receiver.
	  The driver will be called tcc-mipi-csi2
```

## drivers/media/platform/tcc-svdw/Kconfig
```kconfig
# SPDX-License-Identifier: GPL-2.0
#
# Copyright 2020-2022 Telechips Inc.
#
config VIDEO_TCC_SVDW
	tristate "Telechips SVDW (Surround View De-Warp) Driver"
	depends on ARCH_TCC750X || ARCH_TCC807X
	depends on VIDEO_V4L2 && OF && HAS_DMA
	default n
	select DMA_DECLARE_COHERENT
	select V4L2_FWNODE
	select VIDEOBUF2_DMA_CONTIG
	select VIDEO_V4L2_SUBDEV_API
	help
		Support SVDW device driver
```

## drivers/media/platform/tccvdec/Kconfig
```kconfig
# drivers/media/platform/tccvdec/Kconfig
#
# Copyright (c) 2020-2020 Telechips Co., Ltd.
#	http://www.telechips.com/
# Licensed under GPL

# config V4L2_TCCVDEC
# 	tristate "Telechips Video Decoder Driver"
# 	default m
# 	help
# 	Support v4l2 decoder interface

# 	Note that the driver is supported on the following chipsets.
# 	- tcc807x

config VIDEO_TELECHIPS_VPU_DECODER
	tristate "Telechips Video Decoder Driver"
	depends on VIDEO_DEV && VIDEO_V4L2 
	select VIDEOBUF2_DMA_CONTIG
	select V4L2_MEM2MEM_DEV
	help
```

## drivers/media/platform/tccvenc/Kconfig
```kconfig
# drivers/media/platform/tccvenc/Kconfig
#
# Copyright (c) 2020-2020 Telechips Co., Ltd.
#	http://www.telechips.com/
# Licensed under GPL

# config V4L2_TCCVENC
# 	tristate "Telechips Video Encoder Driver"
# 	default m
# 	help
# 	Support v4l2 encoder interface

# 	Note that the driver is supported on the following chipsets.
# 	- tcc807x

config VIDEO_TELECHIPS_VPU_ENCODER
	tristate "Telechips Video Encoder Driver"
	depends on VIDEO_DEV && VIDEO_V4L2
	select VIDEOBUF2_DMA_CONTIG
	select V4L2_MEM2MEM_DEV
	help
```

## drivers/media/platform/tccvin2/Kconfig
```kconfig
# SPDX-License-Identifier: GPL-2.0-or-later
#
# Copyright (C) Telechips Inc.
#

config VIDEO_TCCVIN2
	tristate "Telechips Video-Input Path Driver V2"
	depends on VIDEO_V4L2 && OF && HAS_DMA
	default n
	select DMA_DECLARE_COHERENT
	select V4L2_FWNODE
	select VIDEOBUF2_DMA_CONTIG
	select VIDEO_V4L2_SUBDEV_API
	help
	Support v4l2 capture interface

	Note that the driver is supported on the following chipsets.
	- tcc803x
	- tcc805x

config OVERLAY_PGL
	bool "Overlay Video-Input with Parking Guide Line"
	depends on VIDEO_TCCVIN2
	default n
	help
	Support overlay function of static pgl on the camera preview

	Note that the driver is supported on the following conditions.
	- The pgl image is loaded on bootloader step.
	- The related device node is updated to overlay.
```

## drivers/media/platform/tccvout/Kconfig
```kconfig
# SPDX-License-Identifier: GPL-2.0-only
#
# Copyright (C) Telechips Inc.
#
# Telechips VOUT (Vidoe OUTput) Driver Configuration
#----------------------------------------------------------------

#
# Debuggind Option
#
config TELECHIPS_VOUT_DEBUG
	bool "Telechips VOUT debugging"
	default n
	help
	  This is an option for use by developers; most people should
	  say N here.  This enables vout driver debugging.

config TELECHIPS_VOUT_DBG_INFO
	bool "Telechips VOUT debugging for info"
	depends on TELECHIPS_VOUT_DEBUG
	default n
	help
	  This is an option for use by developers; most people should
	  say N here.  This enables vout driver debugging.

config TELECHIPS_VOUT_DBG_BUF
	bool "Telechips VOUT debugging for buffer"
	depends on TELECHIPS_VOUT_DEBUG
	default n
	help
	  This is an option for use by developers; most people should
	  say N here.  This enables vout driver debugging.

config TELECHIPS_VOUT_DBG_INT
	bool "Telechips VOUT debugging for interrupt"
	depends on TELECHIPS_VOUT_DEBUG
	default n
	help
	  This is an option for use by developers; most people should
	  say N here.  This enables vout driver debugging.

#
# Vsync Option
#
#config VOUT_USE_VSYNC_INT
#	bool "Use vsync interrupt"
#	default n
#
#config VOUT_DISPLAY_LASTFRAME
#	bool "Use last frame interface"
#	default n

#
# Subtitle plane support
#
config VOUT_USE_SUB_PLANE
	bool "Use HW subtitle plane"
	default n
	help
	  It's used to support HW subtitle plane

#
# Keep video layer
#
config VOUT_KEEP_VIDEO_LAYER
	bool "Keep HW video layer when running camera driver"
	depends on (TCC_VIOCMG)
	default n
	help
	  It's used to keep video layer when running camera driver.
```

## drivers/misc/telechips/Kconfig
```kconfig
# SPDX-License-Identifier: GPL-2.0-only
#
# Telechips Misc devices
#

menu "Telechips Misc devices"
	depends on ARCH_TELECHIPS

config ICTC
	tristate "ICTC driver"
	default n

config TELECHIPS_SDR
	tristate "Telechips Digital I/Q Driver for SDR"
	depends on (ARCH_TCC803X || ARCH_TCC805X || ARCH_TCC807X || ARCH_TCC899X || ARCH_TCC901X)
	default n
	help
		This driver supports receiving I/Q data and PCM data from tuner chip.

config TELECHIPS_NPU
		tristate "Telechips NPU driver"
		depends on (ARCH_TCC750X)
		default y
		help
			Telechips NPU driver for tcc750x (N-Dolphin)

#
# Display part drivers
#
config TELECHIPS_WMIXER
  tristate "Telechips Wmixer driver"
  depends on ARCH_TELECHIPS
  default n
  help
    Telechips Windows Mixer driver.

config TELECHIPS_SCALER
	tristate "Telechips Scaler driver"
	depends on ARCH_TELECHIPS
	default n
	help
		Telechips Scaler driver.

config TELECHIPS_G2D
	tristate "Telechips Graphic 2D controller driver"
	depends on VIOC_G2D
	default n
	help
		TCC Graphic 2D Controller driver.

config TELECHIPS_MISC
	tristate "Telechips misc driver"
	depends on ARCH_TELECHIPS
	default n
	help
		Telechips miscellaneous driver.

endmenu
```
