## arch/arm64/configs/tcc807x_subcore_defconfig
```kconfig
CONFIG_LOCALVERSION="-telechips"
# CONFIG_LOCALVERSION_AUTO is not set
# CONFIG_SWAP is not set
CONFIG_SYSVIPC=y
CONFIG_NO_HZ_IDLE=y
CONFIG_HIGH_RES_TIMERS=y
CONFIG_PREEMPT=y
CONFIG_BSD_PROCESS_ACCT=y
CONFIG_BSD_PROCESS_ACCT_V3=y
CONFIG_TASKSTATS=y
CONFIG_TASK_DELAY_ACCT=y
CONFIG_TASK_XACCT=y
CONFIG_TASK_IO_ACCOUNTING=y
CONFIG_IKCONFIG=y
CONFIG_IKCONFIG_PROC=y
CONFIG_MEMCG=y
CONFIG_RT_GROUP_SCHED=y
CONFIG_CGROUP_FREEZER=y
CONFIG_CGROUP_CPUACCT=y
CONFIG_CGROUP_DEBUG=y
CONFIG_NAMESPACES=y
CONFIG_SCHED_AUTOGROUP=y
CONFIG_BLK_DEV_INITRD=y
CONFIG_INITRAMFS_SOURCE="${srctree}/initramfs64.cpio.lzo"
CONFIG_KALLSYMS_ALL=y
CONFIG_EMBEDDED=y
# CONFIG_COMPAT_BRK is not set
CONFIG_ARCH_TELECHIPS=y
CONFIG_ARCH_TCC807X=y
CONFIG_TCC807X_CA55_SUB=y
CONFIG_COMPAT=y
# CONFIG_EFI is not set
CONFIG_PM_AUTOSLEEP=y
CONFIG_PM_WAKELOCKS=y
CONFIG_PM_DEBUG=y
CONFIG_CPU_IDLE=y
CONFIG_TCC_SC_FW_PROTOCOL=y
CONFIG_TCC_IPI_PROTOCOL=y
CONFIG_ARM64_CRYPTO=y
CONFIG_CRYPTO_SHA1_ARM64_CE=y
CONFIG_CRYPTO_SHA2_ARM64_CE=y
CONFIG_CRYPTO_SHA512_ARM64_CE=y
CONFIG_CRYPTO_GHASH_ARM64_CE=y
CONFIG_CRYPTO_AES_ARM64_CE_CCM=y
CONFIG_CRYPTO_AES_ARM64_CE_BLK=y
CONFIG_CRYPTO_CHACHA20_NEON=y
CONFIG_CRYPTO_NHPOLY1305_NEON=y
CONFIG_CRYPTO_AES_ARM64_BS=y
CONFIG_MODULES=y
CONFIG_MODULE_UNLOAD=y
CONFIG_MODULE_FORCE_UNLOAD=y
CONFIG_MODVERSIONS=y
# CONFIG_BLK_DEV_BSG is not set
CONFIG_PARTITION_ADVANCED=y
# CONFIG_CORE_DUMP_DEFAULT_ELF_HEADERS is not set
CONFIG_KSM=y
CONFIG_CMA=y
CONFIG_NET=y
CONFIG_PACKET=y
CONFIG_UNIX=y
# CONFIG_WIRELESS is not set
CONFIG_PCI=y
CONFIG_PCI_HOST_GENERIC=y
CONFIG_DEVTMPFS=y
CONFIG_DEVTMPFS_MOUNT=y
# CONFIG_PREVENT_FIRMWARE_BUILD is not set
CONFIG_SCSI=y
# CONFIG_SCSI_PROC_FS is not set
CONFIG_BLK_DEV_SD=y
CONFIG_CHR_DEV_SG=y
# CONFIG_SCSI_LOWLEVEL is not set
# CONFIG_INPUT_LEDS is not set
CONFIG_INPUT_EVDEV=y
# CONFIG_INPUT_KEYBOARD is not set
# CONFIG_INPUT_MOUSE is not set
CONFIG_INPUT_TOUCHSCREEN=y
CONFIG_TOUCHSCREEN_ATMEL_MXT=y
CONFIG_TOUCHSCREEN_INIT_SERDES=y
CONFIG_TOUCHSCREEN_GT9XX=y
# CONFIG_SERIO_SERPORT is not set
CONFIG_SERIO_AMBAKMI=y
# CONFIG_LEGACY_PTYS is not set
CONFIG_SERIAL_AMBA_PL011=y
CONFIG_SERIAL_TELECHIPS_AMBA_PL011=y
CONFIG_SERIAL_AMBA_PL011_CONSOLE=y
CONFIG_HW_RANDOM=y
# CONFIG_DEVPORT is not set
CONFIG_I2C=y
CONFIG_I2C_CHARDEV=y
CONFIG_I2C_MUX=y
CONFIG_SPI=y
CONFIG_SPI_TCC=y
CONFIG_SPI_SPIDEV=y
CONFIG_SPI_SLAVE=y
CONFIG_PINCTRL_TELECHIPS=y
CONFIG_PINCTRL_TCC_SCFW=y
CONFIG_GPIO_SYSFS=y
CONFIG_GPIO_TELECHIPS=y
# CONFIG_HWMON is not set
CONFIG_THERMAL=y
CONFIG_TELECHIPS_THERMAL=y
CONFIG_WATCHDOG=y
CONFIG_TCC_CBUS_WATCHDOG=y
CONFIG_MFD_ROHM_BD96801=y
CONFIG_REGULATOR=y
CONFIG_REGULATOR_FIXED_VOLTAGE=y
CONFIG_REGULATOR_BD96801=y
CONFIG_REGULATOR_GPIO=y
CONFIG_REGULATOR_MPQ7920=y
CONFIG_MEDIA_SUPPORT=y
CONFIG_V4L_PLATFORM_DRIVERS=y
# CONFIG_VGA_ARB is not set
CONFIG_FB=y
CONFIG_BACKLIGHT_CLASS_DEVICE=y
CONFIG_BACKLIGHT_GPIO=y
CONFIG_DUMMY_CONSOLE_COLUMNS=160
CONFIG_DUMMY_CONSOLE_ROWS=64
CONFIG_UHID=y
CONFIG_USB=y
CONFIG_VBUS_CTRL_DEF_ENABLE=y
CONFIG_USB_EHCI_HCD=y
CONFIG_USB_EHCI_TCC=y
CONFIG_USB_OHCI_HCD=y
CONFIG_USB_OHCI_TCC=y
CONFIG_USB_STORAGE=y
CONFIG_MMC=y
# CONFIG_PWRSEQ_EMMC is not set
# CONFIG_PWRSEQ_SIMPLE is not set
CONFIG_MMC_BLOCK_MINORS=16
CONFIG_NEW_LEDS=y
CONFIG_LEDS_CLASS=y
CONFIG_LEDS_GPIO=y
CONFIG_LEDS_TRIGGERS=y
CONFIG_LEDS_TRIGGER_TIMER=y
CONFIG_LEDS_TRIGGER_HEARTBEAT=y
CONFIG_RTC_CLASS=y
# CONFIG_RTC_INTF_SYSFS is not set
# CONFIG_RTC_INTF_PROC is not set
CONFIG_DMADEVICES=y
CONFIG_TELECHIPS_AMBA_PL08X=y
CONFIG_SYNC_FILE=y
CONFIG_VIRTIO_BALLOON=y
CONFIG_VIRTIO_MMIO=y
CONFIG_STAGING=y
CONFIG_COMMON_CLK_TELECHIPS=y
CONFIG_MAILBOX=y
CONFIG_MAILBOX_TCC=y
CONFIG_ARM_SMMU_V3=y
CONFIG_PHY_XGENE=y
CONFIG_EXT2_FS=y
CONFIG_EXT3_FS=y
CONFIG_EXT3_FS_POSIX_ACL=y
# CONFIG_DNOTIFY is not set
CONFIG_FUSE_FS=y
CONFIG_VFAT_FS=y
CONFIG_PROC_KCORE=y
CONFIG_TMPFS=y
CONFIG_TMPFS_POSIX_ACL=y
# CONFIG_MISC_FILESYSTEMS is not set
# CONFIG_NETWORK_FILESYSTEMS is not set
CONFIG_NLS_CODEPAGE_437=y
CONFIG_NLS_ASCII=y
CONFIG_NLS_ISO8859_1=y
CONFIG_NLS_UTF8=y
# CONFIG_CRYPTO_HW is not set
CONFIG_DMA_CMA=y
CONFIG_CMA_SIZE_PERCENTAGE=15
CONFIG_CMA_SIZE_SEL_PERCENTAGE=y
CONFIG_PRINTK_TIME=y
CONFIG_DYNAMIC_DEBUG=y
# CONFIG_DEBUG_BUGVERBOSE is not set
CONFIG_DEBUG_INFO=y
CONFIG_MAGIC_SYSRQ=y
CONFIG_DEBUG_VM=y
CONFIG_PANIC_ON_OOPS=y
CONFIG_PANIC_TIMEOUT=1
CONFIG_SOFTLOCKUP_DETECTOR=y
CONFIG_BOOTPARAM_SOFTLOCKUP_PANIC=y
CONFIG_SCHEDSTATS=y
# CONFIG_DEBUG_PREEMPT is not set
CONFIG_DEBUG_SPINLOCK=y
# CONFIG_FTRACE is not set
```

## drivers/char/camipc/Kconfig
```kconfig
# SPDX-License-Identifier: GPL-2.0-or-later
#
# Copyright (C) 2023 Telechips Inc.
#
config TELECHIPS_CAMIPC
	tristate "CAMIPC Driver"
	default n
  depends on TCC_IPI_PROTOCOL || TCC_MULTI_MAILBOX || TCC_MAILBOX_CLIENT
	help
          Choose this option if you wish to utilize the camipc driver.
          The camipc driver utilizes a mailbox for communication, including
          communication between the main and subcore for OVP changes and
          communication between the subcore and mcu for TRVC.
```

## drivers/char/displayport/Kconfig
```kconfig
# SPDX-License-Identifier: GPL-2.0-or-later
#
# Copyright (C) Telechips Inc.
#

config TELECHIPS_DP_DRIVER_V1_4
	tristate "Support DisplayPort V1.4 drivers"
	depends on ARCH_TCC805X || ARCH_TCC807X
	default n
	help
		It supports DisplayPort Tx V1.4.
		It will make kernel compile DisplayPort V1.4 drivers.
		It's for DP Tx functionalities.
		It's based on Vesa V1.4.

config MAX968XX_DP_SERDES
	tristate "Max968xx DP SerDes Driver"
	default n
	depends on TELECHIPS_DP_DRIVER_V1_4
	help
		Supports Max96851 as DP serailizer and 96878 as deserializer.

config DPTX_V14_AUDIO
	tristate "DP Tx Audio Driver"
	default n
	depends on TELECHIPS_DP_DRIVER_V1_4
	help
		Supports DP Tx Audio Driver Interface in DP Tx API. driver layer.
```

## drivers/char/screen_share/Kconfig
```kconfig
config TELECHIPS_SCREEN_SHARE_DRV
	tristate "Telechips Screen Share Driver"
	depends on TELECHIPS_SCREEN_SHARE
	default n
	help
		Choose this option if you want to use camipc driver.
		Camipc uses a mailbox to communicate.
		Communication between main, subcore for ovp change.
		Communication between subcore and micom for trvc.
```

## drivers/char/tcc_hsm/Kconfig
```kconfig
# SPDX-License-Identifier: GPL-2.0-or-later
#
# Copyright (C) 2023 Telechips Inc.

config TELECHIPS_HSM
	tristate "TELECHIPS HSM"
	depends on TELECHIPS_SEC_IPC
	default y
	help
		Support to HSM based on Cortex-M4 or SC000
```

## drivers/char/tcc_ipc/Kconfig
```kconfig
config TELECHIPS_IPC
	tristate "TCC IPC Driver for TCC803x/TCC805x/TCC807X"
	default n
	depends on TCC_IPI_PROTOCOL
	help
		TCC IPC only supports TCC803x/TCC805x/TCC807x.
		TCC IPC is a driver that communicates between cores.
		Supprot Core :
		Main core <-> Subcore (TCC807x)
		Main core <-> Subcore, Main Core <-> MICOM, Sub Core <-> MICOM (TCC803x, TCC805x)
```

## drivers/char/tcc_snor_updater/Kconfig
```kconfig
config TELECHIPS_SNOR_UPDATER
	tristate "TCC SNOR Update Driver for TCC805x"
	default n
        depends on TCC_IPI_PROTOCOL
	help
		This driver only supports TCC805x.
		This driver communicate with the internal mcu to update SNOR.
```

## drivers/char/tcc_thsm/Kconfig
```kconfig
# SPDX-License-Identifier: GPL-2.0-or-later
#
# Copyright (C) 2023 Telechips Inc.

config TELECHIPS_THSM
	tristate "TELECHIPS THSM"
	depends on TELECHIPS_SEC_IPC
	default n
	help
		Support to THSM based on CA7,R5, <-> CA53 communication
```

## drivers/char/telechips/mipi_dsi_v2/Kconfig
```kconfig
config TELECHIPS_DSI_DRIVER_V2
	bool "Support TCC MIPI DSI V2 drivers"
	depends on ARCH_TCC807X
	default y
	help
		It supports Telechips MIPI DSI V2 drivers
```

## drivers/char/vpu/Kconfig
```kconfig
#
# VPU device configuration
#

menuconfig TELECHIPS_VPU_DRV
	tristate "VPU-Video Process Unit"
	help
		This option enables the Telechips VPU V2 driver as a loadable module.

if TELECHIPS_VPU_DRV || TELECHIPS_VPU_V3_DRV

choice
	prompt "Max Frame Size (W x H)"
	default VDEC_MAX_FRAME_SIZE_1
	depends on (ARCH_TCC899X || ARCH_TCC901X || ARCH_TCC805X || ARCH_TCC807X)
	help
		max frame size(width/height) for decoder.
		This adds support
		the VPU drivers
		on TCCxxxx Soc devices.

config VDEC_MAX_FRAME_SIZE_1
	bool "4096x2160"
	help
		DEC_MAX_FRAME_SIZE_1
		This adds support
		the VPU drivers.
		on TCCxxxx Soc devices.

config VDEC_MAX_FRAME_SIZE_2
	bool "3840x2160"
	help
		DEC_MAX_FRAME_SIZE_2
		This adds support
		the VPU drivers
		on TCCxxxx Soc devices.
endchoice

config VPU_TIME_MEASUREMENT
	bool "processing time masurement"
	help
		Enable to measure the time of decoding/encoding.
		This adds support
		the VPU drivers
		on TCCxxxx Soc devices.

choice
	prompt "Select VPU Target SDK"
	default TELECHIPS_VPU_IVI
	help
		Enable to select VPU DTSI configuration for each SDK

config TELECHIPS_VPU_IVI
	bool "IVI SDK (LinuxIVI or AndroidIVI)"
	select IVI
	help
		TELECHIPS_VPU_IVI

config TELECHIPS_VPU_DVRS
	bool "DVRS"
	select DVRS
	help
		TELECHIPS_VPU_DVRS
		Enable to select VPU DTSI configuration for DVRS

config TELECHIPS_VPU_CONSOLIDATION
	bool "CONSOLIDATION_IVI_DVRS"
	select CONSOLIDATION_IVI_DVRS
	help
		TELECHIPS_VPU_CONSOLIDATION
		Enable to select VPU DTSI configuration
		for DVRS_IVI Consolidation SDK

config TOPST
	bool "TOPST SDK"
	help
		Telechips Open Platform for System development and Training

endchoice


endif # TELECHIPS_VPU_DRV || TELECHIPS_VPU_V3_DRV
```

## drivers/char/vpu_v3/Kconfig
```kconfig
#
# VPU v3 device configuration
#

menuconfig TELECHIPS_VPU_V3_DRV
	tristate "Telechips VPU V3 Driver"
	help
		This option enables the Telechips VPU V3 driver as a loadable module.

if TELECHIPS_VPU_V3_DRV

choice
	prompt "Max Frame Size (W x H)"
	default VDEC_MAX_FRAME_SIZE_1
	depends on (ARCH_TCC899X || ARCH_TCC901X || ARCH_TCC805X || ARCH_TCC807X)
	help
		max frame size(width/height) for decoder.
		This adds support
		the VPU drivers
		on TCCxxxx Soc devices.

config VDEC_MAX_FRAME_SIZE_1
	bool "4096x2160"
	help
		DEC_MAX_FRAME_SIZE_1
		This adds support
		the VPU drivers.
		on TCCxxxx Soc devices.

config VDEC_MAX_FRAME_SIZE_2
	bool "3840x2160"
	help
		DEC_MAX_FRAME_SIZE_2
		This adds support
		the VPU drivers
		on TCCxxxx Soc devices.
endchoice

config VPU_TIME_MEASUREMENT
	bool "processing time masurement"
	help
		Enable to measure the time of decoding/encoding.
		This adds support
		the VPU drivers
		on TCCxxxx Soc devices.

config TOPST
	bool "TOPST SDK"
	default y
	help
		Telechips Open Platform for System development and Training

endif #TELECHIPS_VPU_V3_DRV
```
